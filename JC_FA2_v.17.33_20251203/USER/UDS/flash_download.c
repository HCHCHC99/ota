#include "flash_download.h"
#include "flash_advanced.h"
#include "rtt_log.h"
#include <string.h>
#include <stdlib.h>
#include <stdio.h>

// ============ 调试宏 ============
#define FW_LOG_D(fmt, ...)  LOG_CH(LOG_CH_MAIN, LOG_LEVEL_DEBUG, COLOR_CYAN,   "FW", fmt, ##__VA_ARGS__)
#define FW_LOG_I(fmt, ...)  LOG_CH(LOG_CH_MAIN, LOG_LEVEL_INFO,  COLOR_GREEN, "FW", fmt, ##__VA_ARGS__)
#define FW_LOG_W(fmt, ...)  LOG_CH(LOG_CH_MAIN, LOG_LEVEL_WARN,  COLOR_YELLOW,"FW", fmt, ##__VA_ARGS__)
#define FW_LOG_E(fmt, ...)  LOG_CH(LOG_CH_MAIN, LOG_LEVEL_ERROR, COLOR_RED,   "FW", fmt, ##__VA_ARGS__)


// ============ BIN data dump (PRINTF_BIN) ============
#define PRINTF_BIN
#ifdef PRINTF_BIN
#define BIN_OTA(fmt, ...)  LOG_CH(LOG_CH_MAIN, LOG_LEVEL_DEBUG, COLOR_CYAN, "OTA", fmt, ##__VA_ARGS__)
#define BIN_MAGIC_LEN      8
#define BIN_BYTES_PER_LINE 16
static const uint8_t g_bin_magic[BIN_MAGIC_LEN] = {0x12, 0x34, 0x56, 0x78, 0x12, 0x34, 0x56, 0x78};
static bool g_bin_triggered = false;
#endif
// ============ 配置参数 ============
#define FW_DEFAULT_MAX_SIZE         (256 * 1024)    // 默认最大256KB
#define FW_DEFAULT_SECTOR_SIZE      0x2000          // 8KB扇区
#define FW_DEFAULT_VERIFY_ENABLED   1               // 默认启用校验
#define FW_DEFAULT_AUTO_RESET       0               // 默认不自动复位

// ============ 方案B：60KB RAM缓冲区 ============
// 用于暂存整个固件数据，0x37时校验通过后再写入Flash
static uint8_t g_fw_ram_buffer[FW_RAM_BUFFER_SIZE] __attribute__((aligned(4)));

// ============ 内部状态结构 ============
typedef struct
{
    // 状态
    FlashDownloadState_t state;
    FlashDownloadResult_t last_error;
    
    // 升级参数
    uint32_t target_address;
    uint32_t total_size;
    uint32_t received_size;
    
    // RAM缓冲区偏移（方案B：直接写入g_fw_ram_buffer）
    uint32_t buffer_offset;
    
    // 序列号
    uint8_t expected_sequence;
    
    // 配置
    FlashDownloadConfig_t config;
    
    // Flash句柄
    FlashAdvHandle_t* flash_handle;
    
    // 统计
    uint32_t sector_erased_count;
    uint32_t block_written_count;
    
    // 延迟处理标志（用于NRC 0x78）
    bool pending_response;
    
    // 方案B：接收过程中实时计算的CRC
    uint32_t rx_crc;
    
} FlashDownloadContext_t;

// ============ 全局上下文 ============
static FlashDownloadContext_t g_fw_ctx;
static bool g_fw_initialized = false;

// ============ 内部函数声明 ============
static void fw_set_state(FlashDownloadState_t new_state);
static void fw_set_error(FlashDownloadResult_t error);
static bool fw_is_address_valid(uint32_t address);
static bool fw_is_address_protected(uint32_t address);
static uint32_t fw_get_sector_start(uint32_t address);
static FlashDownloadResult_t fw_erase_range(uint32_t start_addr, uint32_t end_addr);
static FlashDownloadResult_t fw_write_buffer_to_flash(uint32_t flash_addr, const uint8_t* buffer, uint32_t size);
static uint32_t fw_calculate_crc32(const uint8_t* data, uint32_t len);

// ============ 内部函数实现 ============

static void fw_set_state(FlashDownloadState_t new_state)
{
    if (g_fw_ctx.state != new_state) {
        FW_LOG_I("State: %d -> %d", g_fw_ctx.state, new_state);
        g_fw_ctx.state = new_state;
    }
}

static void fw_set_error(FlashDownloadResult_t error)
{
    g_fw_ctx.last_error = error;
    FW_LOG_E("Error set: %d", error);
}

static bool fw_is_address_valid(uint32_t address)
{
#if FW_FLASH_WRITE_ENABLED
    return (address >= FW_APP_START_ADDR && 
            address < (FW_APP_START_ADDR + FW_APP_MAX_SIZE));
#else
    (void)address;
    return true;
#endif
}
static bool fw_is_address_protected(uint32_t address)
{
    if (g_fw_ctx.flash_handle == NULL) {
        return false;
    }
    return FlashAdv_IsAddressProtected(g_fw_ctx.flash_handle, address);
}

static uint32_t fw_get_sector_start(uint32_t address)
{
    return address & ~(g_fw_ctx.config.flash_sector_size - 1);
}

/**
 * @brief 擦除指定地址范围（自动对齐到扇区边界）
 */
static FlashDownloadResult_t fw_erase_range(uint32_t start_addr, uint32_t end_addr)
{
    if (g_fw_ctx.flash_handle == NULL) {
        return FW_RESULT_NOT_READY;
    }
    
    uint32_t sector_size = g_fw_ctx.config.flash_sector_size;
    uint32_t start_sector = fw_get_sector_start(start_addr);
    uint32_t end_sector = fw_get_sector_start(end_addr);
    uint32_t erased_count = 0;
    uint32_t skipped_count = 0;
    
    FW_LOG_I("Erasing range: 0x%08X - 0x%08X", start_sector, end_sector);
    
    for (uint32_t sector_addr = start_sector; sector_addr <= end_sector; sector_addr += sector_size) {
        
        // 检查保护区域
        if (fw_is_address_protected(sector_addr)) {
            FW_LOG_W("Skipping protected sector at 0x%08X", sector_addr);
            skipped_count++;
            continue;
        }
        
        // 检查扇区是否已经擦除
        bool need_erase = false;
        for (uint32_t i = 0; i < sector_size / 4; i++) {
            uint32_t word = FlashAdv_ReadWord(g_fw_ctx.flash_handle, sector_addr + i * 4);
            if (word != 0xFFFFFFFF) {
                need_erase = true;
                break;
            }
        }
        
        if (!need_erase) {
            FW_LOG_D("Sector 0x%08X already erased, skipping", sector_addr);
            skipped_count++;
            continue;
        }
        
        // 执行擦除
        FlashAdvStatus_t status = FlashAdv_EraseSector(g_fw_ctx.flash_handle, sector_addr);
        if (status != FLASH_ADV_OK) {
            FW_LOG_E("Erase failed at 0x%08X, status=%d", sector_addr, status);
            return FW_RESULT_ERASE_FAILED;
        }
        
        // 验证擦除
        uint32_t verify = FlashAdv_ReadWord(g_fw_ctx.flash_handle, sector_addr);
        if (verify != 0xFFFFFFFF) {
            FW_LOG_E("Erase verify failed at 0x%08X, read=0x%08X", sector_addr, verify);
            return FW_RESULT_ERASE_FAILED;
        }
        
        erased_count++;
        g_fw_ctx.sector_erased_count++;
        
        FW_LOG_D("Erased sector at 0x%08X", sector_addr);
    }
    
    FW_LOG_I("Erase complete: %d erased, %d skipped", erased_count, skipped_count);
    return FW_RESULT_OK;
}

/**
 * @brief 将数据写入Flash（4字节对齐写入）
 */
static FlashDownloadResult_t fw_write_buffer_to_flash(uint32_t flash_addr, const uint8_t* buffer, uint32_t size)
{
    if (g_fw_ctx.flash_handle == NULL) {
        return FW_RESULT_NOT_READY;
    }
    
    // 检查地址有效性
    if (!fw_is_address_valid(flash_addr)) {
        FW_LOG_E("Write address invalid: 0x%08X", flash_addr);
        return FW_RESULT_ADDR_INVALID;
    }
    
    // 检查保护区域
    if (fw_is_address_protected(flash_addr)) {
        FW_LOG_E("Write address protected: 0x%08X", flash_addr);
        return FW_RESULT_ADDR_INVALID;
    }
    
    // 计算需要写入的字数（4字节对齐）
    uint32_t word_count = (size + 3) / 4;
    uint32_t aligned_size = word_count * 4;
    
    // 扩展缓冲区到4字节对齐
    uint32_t aligned_buffer[FW_RAM_BUFFER_SIZE / 4 + 1];
    memcpy(aligned_buffer, buffer, size);
    for (uint32_t i = size; i < aligned_size; i++) {
        ((uint8_t*)aligned_buffer)[i] = 0xFF;  // 填充0xFF
    }
    
    FW_LOG_D("Writing to Flash: addr=0x%08X, size=%d, words=%d", 
             flash_addr, size, word_count);
    
    // 写入Flash
    FlashAdvStatus_t status = FlashAdv_BulkWriteSimple(
        g_fw_ctx.flash_handle,
        flash_addr,
        aligned_buffer,
        word_count
    );
    
    if (status != FLASH_ADV_OK) {
        FW_LOG_E("Write failed at 0x%08X, status=%d", flash_addr, status);
        return FW_RESULT_WRITE_FAILED;
    }
    
    g_fw_ctx.block_written_count++;
    
    return FW_RESULT_OK;
}

/**
 * @brief 简单CRC32计算（用于校验）
 */
static uint32_t fw_calculate_crc32(const uint8_t* data, uint32_t len)
{
    uint32_t crc = 0xFFFFFFFF;
    for (uint32_t i = 0; i < len; i++) {
        crc ^= data[i];
        for (int j = 0; j < 8; j++) {
            if (crc & 1) {
                crc = (crc >> 1) ^ 0xEDB88320;
            } else {
                crc >>= 1;
            }
        }
    }
    return ~crc;
}

// ============ 公共接口实现 ============

void FlashDownload_Init(const FlashDownloadConfig_t* config)
{
    FW_LOG_I("=== Flash Download Init Start ===");
    
    memset(&g_fw_ctx, 0, sizeof(g_fw_ctx));
    
    // 设置默认配置
    g_fw_ctx.config.max_firmware_size = FW_DEFAULT_MAX_SIZE;
    g_fw_ctx.config.flash_sector_size = FW_DEFAULT_SECTOR_SIZE;
    g_fw_ctx.config.verify_enabled = FW_DEFAULT_VERIFY_ENABLED;
    g_fw_ctx.config.auto_reset_on_complete = FW_DEFAULT_AUTO_RESET;
    
    // 如果提供了配置，覆盖默认值
    if (config != NULL) {
        if (config->max_firmware_size > 0) {
            g_fw_ctx.config.max_firmware_size = config->max_firmware_size;
        }
        if (config->flash_sector_size > 0) {
            g_fw_ctx.config.flash_sector_size = config->flash_sector_size;
        }
        g_fw_ctx.config.verify_enabled = config->verify_enabled;
        g_fw_ctx.config.auto_reset_on_complete = config->auto_reset_on_complete;
    }
    
    // 初始化Flash高级句柄
    FlashAdvConfig_t flash_cfg = {
        .base_address = 0x00000000,
        .sector_size = g_fw_ctx.config.flash_sector_size,
        .total_size = 0x80000,          // 512KB
        .protected_size = 0,
        .max_erase_cycles = 10000
    };
    
    g_fw_ctx.flash_handle = FlashAdv_Create(&flash_cfg, NULL);
    
    // 获取用户可用区域
    FlashAdv_GetUserRegion(&g_fw_ctx.config.user_start_addr,
                           &g_fw_ctx.config.user_end_addr,
                           NULL);
    
    if (g_fw_ctx.config.user_start_addr == 0) {
        // 如果获取失败，使用默认值（扇区10-62）
        g_fw_ctx.config.user_start_addr = 10 * g_fw_ctx.config.flash_sector_size;
        g_fw_ctx.config.user_end_addr = 63 * g_fw_ctx.config.flash_sector_size;
    }
    
    g_fw_ctx.state = FW_UPDATE_IDLE;
    g_fw_ctx.last_error = FW_RESULT_OK;
    
    FW_LOG_I("User flash range: 0x%08X - 0x%08X",
             g_fw_ctx.config.user_start_addr, g_fw_ctx.config.user_end_addr);
    FW_LOG_I("Max firmware size: %d KB", g_fw_ctx.config.max_firmware_size / 1024);
    FW_LOG_I("=== Flash Download Init Done ===");
    
    g_fw_initialized = true;
}

FlashDownloadResult_t FlashDownload_OnRequestDownload(uint32_t address, uint32_t size)
{
    if (!g_fw_initialized) {
        return FW_RESULT_NOT_READY;
    }
    
    FW_LOG_I(">>> OnRequestDownload: addr=0x%08X, size=%d bytes", address, size);
    
    // 状态检查：必须处于 IDLE
    if (g_fw_ctx.state != FW_UPDATE_IDLE) {
        FW_LOG_W("Wrong state for download: %d", g_fw_ctx.state);
        return FW_RESULT_BUSY;
    }
    
    // 地址有效性检查
    if (!fw_is_address_valid(address)) {
        FW_LOG_E("Invalid address: 0x%08X", address);
        return FW_RESULT_ADDR_INVALID;
    }
    
    // 大小检查
    if (size == 0 || size > g_fw_ctx.config.max_firmware_size) {
        FW_LOG_E("Invalid size: %d (max=%d)", size, g_fw_ctx.config.max_firmware_size);
        return FW_RESULT_SIZE_TOO_LARGE;
    }
    
    // 检查RAM缓冲区是否足够
    if (size > FW_RAM_BUFFER_SIZE) {
        FW_LOG_E("Firmware size %d exceeds RAM buffer %d", size, FW_RAM_BUFFER_SIZE);
        return FW_RESULT_SIZE_TOO_LARGE;
    }
    
    // 记录升级参数
    g_fw_ctx.target_address = address;
    g_fw_ctx.total_size = ((size + 255) / 256) * 256;
    g_fw_ctx.received_size = 0;
    g_fw_ctx.buffer_offset = 0;
    g_fw_ctx.expected_sequence = 1;
    g_fw_ctx.sector_erased_count = 0;
    g_fw_ctx.block_written_count = 0;
    g_fw_ctx.rx_crc = 0xFFFFFFFF;  // 初始化CRC
    
    // 方案B：不清除Flash，数据先存到RAM缓冲区
    // Flash擦除在0x37时进行
    
    // 状态变为 READY
    fw_set_state(FW_UPDATE_READY);
    
    return FW_RESULT_OK;
}

FlashDownloadResult_t FlashDownload_OnTransferData(uint8_t block_sequence_number,
                                                    uint8_t* data,
                                                    uint16_t len)
{
    if (!g_fw_initialized) {
        return FW_RESULT_NOT_READY;
    }
    
    FW_LOG_D(">>> OnTransferData: seq=%d, len=%d", block_sequence_number, len);
    
    // 状态检查
    if (g_fw_ctx.state != FW_UPDATE_READY && g_fw_ctx.state != FW_UPDATE_TRANSFERRING) {
        FW_LOG_W("Wrong state for transfer: %d", g_fw_ctx.state);
        return FW_RESULT_NOT_READY;
    }
    
    // 序列号检查
    if (block_sequence_number != g_fw_ctx.expected_sequence) {
        FW_LOG_W("Sequence mismatch: expected=%d, got=%d",
                 g_fw_ctx.expected_sequence, block_sequence_number);
        return FW_RESULT_SEQUENCE_ERROR;
    }
    
    // 检查是否超出总大小
    if (g_fw_ctx.received_size + len > g_fw_ctx.total_size) {
        FW_LOG_E("Would exceed total size: received=%d, add=%d, total=%d",
                 g_fw_ctx.received_size, len, g_fw_ctx.total_size);
        return FW_RESULT_SIZE_TOO_LARGE;
    }
    
    // 检查RAM缓冲区是否溢出
    if (g_fw_ctx.buffer_offset + len > FW_RAM_BUFFER_SIZE) {
        FW_LOG_E("RAM buffer overflow: offset=%d, add=%d, max=%d",
                 g_fw_ctx.buffer_offset, len, FW_RAM_BUFFER_SIZE);
        return FW_RESULT_SIZE_TOO_LARGE;
    }
    
    // 方案B：数据直接写入RAM缓冲区，不写入Flash
    memcpy(&g_fw_ram_buffer[g_fw_ctx.buffer_offset], data, len);
    g_fw_ctx.buffer_offset += len;
    g_fw_ctx.received_size += len;
    
    // 实时计算
#ifdef PRINTF_BIN
    if (!g_bin_triggered) {
        for (uint16_t _i = 0; _i + BIN_MAGIC_LEN <= len; _i++) {
            if (memcmp(&data[_i], g_bin_magic, BIN_MAGIC_LEN) == 0) {
                g_bin_triggered = true;
                break;
            }
        }
    }
    if (g_bin_triggered) {
        g_bin_triggered = false;
        BIN_OTA("=== BIN DUMP START: %d bytes ===", g_fw_ctx.buffer_offset);
        for (uint32_t _off = 0; _off < g_fw_ctx.buffer_offset; _off += BIN_BYTES_PER_LINE) {
            char _ln[64];
            int _p = 0;
            for (uint32_t _j = 0; _j < BIN_BYTES_PER_LINE && (_off + _j) < g_fw_ctx.buffer_offset; _j++) {
                _p += sprintf(_ln + _p, "%02X ", g_fw_ram_buffer[_off + _j]);
            }
            BIN_OTA("%s", _ln);
        }
        BIN_OTA("=== BIN DUMP END ===");
    }
#endif
    // 实时计算 CRC             
    for (uint16_t i = 0; i < len; i++) {
        g_fw_ctx.rx_crc ^= data[i];
        for (int j = 0; j < 8; j++) {
            if (g_fw_ctx.rx_crc & 1) {
                g_fw_ctx.rx_crc = (g_fw_ctx.rx_crc >> 1) ^ 0xEDB88320;
            } else {
                g_fw_ctx.rx_crc >>= 1;
            }
        }
    }
    
    // 更新状态
    if (g_fw_ctx.state == FW_UPDATE_READY) {
        fw_set_state(FW_UPDATE_TRANSFERRING);
    }
    
    // 序列号递增
    g_fw_ctx.expected_sequence++;
    
    return FW_RESULT_OK;
}

FlashDownloadResult_t FlashDownload_OnTransferExit(void)
{
    if (!g_fw_initialized) {
        return FW_RESULT_NOT_READY;
    }
    
    FW_LOG_I(">>> OnTransferExit");
    
    // 状态检查
    if (g_fw_ctx.state != FW_UPDATE_TRANSFERRING &&
        g_fw_ctx.state != FW_UPDATE_READY &&
        g_fw_ctx.state != FW_UPDATE_COMPLETE) {
        FW_LOG_W("Wrong state for transfer exit: %d", g_fw_ctx.state);
        return FW_RESULT_NOT_READY;
    }
    
    if (g_fw_ctx.state == FW_UPDATE_COMPLETE) {
        return FW_RESULT_OK;
    }
    
    // 检查是否接收完整
    if (g_fw_ctx.received_size > g_fw_ctx.total_size) {
        FW_LOG_W("Incomplete transfer: received=%d, total=%d",
                 g_fw_ctx.received_size, g_fw_ctx.total_size);
        return FW_RESULT_SIZE_TOO_LARGE;
    }
    
    // 方案B：CRC校验
    g_fw_ctx.rx_crc = ~g_fw_ctx.rx_crc;  // 完成CRC计算
    FW_LOG_I("Calculated CRC: 0x%08X", g_fw_ctx.rx_crc);
    
    // 进入校验阶段（在FlashDownload_Task中执行擦除+写入）
    fw_set_state(FW_UPDATE_VERIFYING);
    g_fw_ctx.pending_response = true;
    
    return FW_RESULT_OK;
}

void FlashDownload_Task(void)
{
    if (!g_fw_initialized) {
        return;
    }
    
    switch (g_fw_ctx.state)
    {
        case FW_UPDATE_PREPARING:
            // 方案B：0x31擦除只做标记，实际擦除在0x37时进行
            // 此状态不再使用，保留以兼容
            fw_set_state(FW_UPDATE_READY);
            g_fw_ctx.pending_response = false;
            break;
            
        case FW_UPDATE_VERIFYING:
            // 方案B：校验通过后，擦除Flash并写入数据
            {
                FW_LOG_I("Verifying and writing firmware to Flash...");
                
#if FW_FLASH_WRITE_ENABLED
                // 1. 先擦除目标Flash区域
                uint32_t end_addr = g_fw_ctx.target_address + g_fw_ctx.total_size - 1;
                FlashDownloadResult_t erase_result = fw_erase_range(g_fw_ctx.target_address, end_addr);
                
                if (erase_result != FW_RESULT_OK) {
                    FW_LOG_E("Erase failed before write");
                    fw_set_state(FW_UPDATE_ERROR);
                    fw_set_error(erase_result);
                    g_fw_ctx.pending_response = false;
                    break;
                }
                
                // 2. 将RAM缓冲区数据写入Flash
                // 按扇区大小分块写入，避免一次性写入过大
                uint32_t sector_size = g_fw_ctx.config.flash_sector_size;
                uint32_t remaining = g_fw_ctx.received_size;
                uint32_t write_addr = g_fw_ctx.target_address;
                uint32_t buffer_pos = 0;
                bool write_failed = false;
                
                while (remaining > 0) {
                    uint32_t chunk_size = (remaining > sector_size) ? sector_size : remaining;
                    
                    FlashDownloadResult_t write_result = fw_write_buffer_to_flash(
                        write_addr,
                        &g_fw_ram_buffer[buffer_pos],
                        chunk_size
                    );
                    
                    if (write_result != FW_RESULT_OK) {
                        FW_LOG_E("Write failed at addr=0x%08X", write_addr);
                        write_failed = true;
                        break;
                    }
                    
                    write_addr += chunk_size;
                    buffer_pos += chunk_size;
                    remaining -= chunk_size;
                }
                
                if (write_failed) {
                    fw_set_state(FW_UPDATE_ERROR);
                    fw_set_error(FW_RESULT_WRITE_FAILED);
                    g_fw_ctx.pending_response = false;
                    break;
                }
                
                // 3. 校验写入结果（读取Flash并与RAM缓冲区比较）
                if (g_fw_ctx.config.verify_enabled) {
                    FW_LOG_I("Verifying Flash content...");
                    bool verify_ok = true;
                    
                    for (uint32_t i = 0; i < g_fw_ctx.received_size; i += 4) {
                        uint32_t flash_word = FlashAdv_ReadWord(
                            g_fw_ctx.flash_handle,
                            g_fw_ctx.target_address + i
                        );
                        
                        uint32_t expected_word;
                        memcpy(&expected_word, &g_fw_ram_buffer[i], 4);
                        
                        if (flash_word != expected_word) {
                            FW_LOG_E("Verify failed at offset 0x%08X: flash=0x%08X, expected=0x%08X",
                                     i, flash_word, expected_word);
                            verify_ok = false;
                            break;
                        }
                    }
                    
                    if (!verify_ok) {
                        fw_set_state(FW_UPDATE_ERROR);
                        fw_set_error(FW_RESULT_VERIFY_FAILED);
                        g_fw_ctx.pending_response = false;
                        break;
                    }
                    
                    FW_LOG_I("Flash verification PASSED");
                }
#else
                FW_LOG_I("Flash write DISABLED (FW_FLASH_WRITE_ENABLED=0), skipping erase/write/verify");
#endif
                
                // 4. 升级完成
                fw_set_state(FW_UPDATE_COMPLETE);
                g_fw_ctx.pending_response = false;
                
                FW_LOG_I("=== Firmware Update Complete ===");
                FW_LOG_I("Address: 0x%08X, Size: %d bytes (%.2f KB)",
                         g_fw_ctx.target_address, g_fw_ctx.total_size,
                         g_fw_ctx.total_size / 1024.0);
                FW_LOG_I("Sectors erased: %d, Blocks written: %d",
                         g_fw_ctx.sector_erased_count, g_fw_ctx.block_written_count);
                FW_LOG_I("CRC: 0x%08X", g_fw_ctx.rx_crc);
                
                // 自动复位
                if (g_fw_ctx.config.auto_reset_on_complete) {
                    FW_LOG_I("Auto-reset in 1 second...");
                    // NVIC_SystemReset();
                }
            }
            break;
            
        case FW_UPDATE_ERROR:
            // 错误状态，等待外部复位或取消
            break;
            
        default:
            break;
    }
}

FlashDownloadState_t FlashDownload_GetState(void)
{
    return g_fw_ctx.state;
}

void FlashDownload_GetProgress(FlashDownloadProgress_t* progress)
{
    if (progress == NULL) return;
    
    progress->total_size = g_fw_ctx.total_size;
    progress->received_size = g_fw_ctx.received_size;
    progress->target_address = g_fw_ctx.target_address;
    
    if (g_fw_ctx.total_size > 0) {
        progress->progress_percent = (uint8_t)((g_fw_ctx.received_size * 100) / g_fw_ctx.total_size);
    } else {
        progress->progress_percent = 0;
    }
}

FlashDownloadResult_t FlashDownload_GetLastError(void)
{
    return g_fw_ctx.last_error;
}

void FlashDownload_Cancel(void)
{
    FW_LOG_I("Cancelling firmware update");
    fw_set_state(FW_UPDATE_IDLE);
    g_fw_ctx.pending_response = false;
    g_fw_ctx.buffer_offset = 0;
    g_fw_ctx.received_size = 0;
    g_fw_ctx.expected_sequence = 1;
}

void FlashDownload_Reset(void)
{
    FW_LOG_I("Resetting firmware update module");
    
    // 只重置运行时状态，保留配置和 Flash 句柄
    g_fw_ctx.state = FW_UPDATE_IDLE;
    g_fw_ctx.last_error = FW_RESULT_OK;
    g_fw_ctx.target_address = 0;
    g_fw_ctx.total_size = 0;
    g_fw_ctx.received_size = 0;
    g_fw_ctx.buffer_offset = 0;
    g_fw_ctx.expected_sequence = 1;
    g_fw_ctx.sector_erased_count = 0;
    g_fw_ctx.block_written_count = 0;
    g_fw_ctx.pending_response = false;
    g_fw_ctx.rx_crc = 0;
    
    // 不清空 config 和 flash_handle
}

bool FlashDownload_IsPending(void)
{
    return g_fw_ctx.pending_response;
}

FlashDownloadResult_t FlashDownload_Erase(uint32_t address, uint32_t size)
{
    if (!g_fw_initialized) {
        return FW_RESULT_NOT_READY;
    }
    
    if (!fw_is_address_valid(address)) {
        return FW_RESULT_ADDR_INVALID;
    }
    
    // 方案B：0x31擦除只做标记，不实际擦除Flash
    // 实际擦除在0x37时进行
    FW_LOG_I("Erase requested (deferred): addr=0x%08X, size=%d bytes", address, size);
    FW_LOG_I("Actual erase will be performed at TransferExit (0x37)");
    
    // 返回成功，让UDS层认为擦除已完成
    return FW_RESULT_OK;
}

FlashDownloadResult_t FlashDownload_CalculateCRC(uint32_t address, uint32_t size, uint32_t* crc_result)
{
    if (!g_fw_initialized || crc_result == NULL) {
        return FW_RESULT_NOT_READY;
    }
    
    if (!fw_is_address_valid(address)) {
        return FW_RESULT_ADDR_INVALID;
    }
    
    // 从 Flash 读取数据并计算 CRC
    uint32_t crc = 0xFFFFFFFF;
    for (uint32_t offset = 0; offset < size; offset += 4) {
        uint32_t word = FlashAdv_ReadWord(g_fw_ctx.flash_handle, address + offset);
        crc = fw_calculate_crc32((uint8_t*)&word, 4);
    }
    
    *crc_result = ~crc;
    return FW_RESULT_OK;
}


uint16_t FlashDownload_GetFirmwareVersion(void)
{
    // 从 Flash 固定地址读取固件版本号
    // 示例：从应用程序起始地址+偏移读取
    uint32_t version_addr = FW_APP_START_ADDR + 0x10;  // 假设版本号在偏移0x10处
    return (uint16_t)FlashAdv_ReadWord(g_fw_ctx.flash_handle, version_addr);
}

uint16_t FlashDownload_GetBootloaderVersion(void)
{
    // 从 Bootloader 区域读取版本号
    uint32_t version_addr = FW_BOOTLOADER_START_ADDR + 0x10;
    return (uint16_t)FlashAdv_ReadWord(g_fw_ctx.flash_handle, version_addr);
}

uint32_t FlashDownload_GetFirmwareCRC(void)
{
    // 计算或读取存储的 CRC 值
    uint32_t crc_addr = FW_APP_START_ADDR + FW_APP_MAX_SIZE - 4;  // CRC 存储在末尾
    return FlashAdv_ReadWord(g_fw_ctx.flash_handle, crc_addr);
}
