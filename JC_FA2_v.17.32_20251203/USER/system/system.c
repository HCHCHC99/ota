/********************************文件说明*************************************
*文件名: system.c

*作者: Yuchen Tan

*版本: V1.0.0

*功能简介:

*备注: 无

*修改履历:
------------------------------------V1.0.1------------------------------------
20231106
1、增加上位机配置功能，通过上位机配置电机功能和系统功能

*****************************************************************************/

/*****************************文件包含(私有)**********************************
*
*备注: 无
*
*****************************************************************************/
#include "system.h"
#include "main.h"
#include "mc_app.h"
#include "btn.h"
#include "adc_adapter.h"
#include "uart_adapter.h"
#include "flash_adapter.h"
#include "gpio_adapter.h"
#include "timer_adapter.h"
#include "delay_adapter.h"
#include "sys_cfg.h"
#include "modbus.h"    
#include "queue.h"
#include "can_adapter.h"
#include "co.h"
#include "co_sdo.h"  
#include "crc.h"

#include "hz_timer.h"
#include "mc_app.h"
#include "mc_cur.h"
#include "motor_adc.h"
#include "canJ1939.h"
#include "uds_diagnostic.h"
#include "isotp_transport.h"
#include "rtt_log.h"
//#include "debug.h"
/*****************************宏定义(私有)************************************
*
*备注: 本文件中,不希望被外部使用或随意修改的宏在这里定义
*
*****************************************************************************/
/*软件版本*/
#define SW_VERSION				(1)
#define SW_MINI_VERSION			(1)

/*注: FLAG,VALUE必须单独用括号括起来,防止VALUE是一个位与组合值,展开后出错*/
#define SYSTEM_SET_FLAG(FLAG, VALUE)    ((FLAG) |= (VALUE))
#define SYSTEM_CLR_FLAG(FLAG, VALUE)    ((FLAG) &= ~(VALUE))
#define SYSTEM_GET_FLAG(FLAG, VALUE)    ((FLAG) & (VALUE))
#define SYSTEM_MATCH_FLAG(FLAG, VALUE)  ((FLAG) == (VALUE))

/*系统LED定义*/
#define LED1                    (0)
#define LED2                    (1)

/*系统按键定义*/
#define KEY_MOTOR_DOWN          (BTN_2)     //电机下降运行键
#define KEY_MOTOR_UP            (BTN_1)     //电机上升运行键

/*电机限位标准定义*/
#define MOTOR_POS_TOP           (0x01)
#define MOTOR_POS_BTM           (0x10)

/*系统电机动作标志*/
#define M1_UP                   (0x01)
#define M1_DOWN                 (0x01<<8)
#define M1_MOVE                 (M1_UP | M1_DOWN)
#define M2_UP                   (0x02)
#define M2_DOWN                 (0x02<<8)
#define M2_MOVE                 (M2_UP | M2_DOWN)

//
/*限位标志*/
#define M1_TOP                  (0x01)
#define M1_BTM                  (0x01<<8)
#define M2_TOP                  (0x02)
#define M2_BTM                  (0x02<<8)
#define M_LOCKED_FLAG			(0x01)


/*系统正常工作指示灯闪烁时间*/
#define SYSTEM_RUN_LED_TIME		500		
/*零位HALL值定义*/
//#define TOP_POS_HALLDATA       		(MAX_ROUTE)
/*零位HALL值定义*/
#define BTM_POS_HALLDATA       		(0)
/*零位HALL值定义*/
//#define CAN_ZERO_POS_HALLDATA       (500000)


/*推杆行程位置索引定义*/
#define COLUMN_POS_ZERO         (0)     //零位位置(复位完成的位置)
#define COLUMN_POS_SET_BTM      (1)     //软件设置下限位
#define COLUMN_POS_TOP_LIMIT    (2)     //软件最大行程
#define COLUMN_POS_SET_TOP      (3)     //软件设置上限位
#define COLUMN_POS_MEMORY1      (4)     //记忆位置1
#define COLUMN_POS_MEMORY2      (5)     //记忆位置2
#define COLUMN_POS_MEMORY3      (6)     //记忆位置3
#define COLUMN_POS_MEMORY4      (7)     //记忆位置4
#define COLUMN_POS_NB           (8)

/*FLASH存储标志位*/
#define FS_MOTOR_SATE           (0x01)
#define FS_MOTOR_LIMIT          (0x02)
#define FS_SYS_PARAM			(0x08)
#define	FS_SYS_CONFIG			(0x10)
#define FS_MOTOR_CONFIG			(0x20)
#define	FS_BOOT_CONFIG			(0x40)


/*FLASH存储区域定义*/
#define FSA_MOTOR_STATE         BLOCK_L1_ADDR   //存电机位置
#define FSA_MOTOR_LIMIT         BLOCK_L2_ADDR   //存电机限位
#define FSA_SYS_PARAM     		BLOCK_L3_ADDR   //存储系统参数(CanOpen节点信息)

/*模块函数操作返回值定义*/
#define	MSG_RET_OK			(1)
#define	MSG_RET_ERR_MA		(-1)	//内存分配失败
#define	MSG_RET_ERR_PARAM	(-2)	//接口参数错误
#define	MSG_RET_ERR_PACK	(-3)	//数据打包失败
#define	MSG_RET_ERR_CRC		(-4)	//数据校验失败 



/**************************数据类型及结构定义(私有)***************************
*
*备注: 本文件中,不希望被外部使用的数据结构及类型在这里定义
*
*****************************************************************************/

/*应用层定义-modbus寄存器*/
typedef enum
{
    MBREG_MOTOR_SLAVE_ADDR = 40001,     //电机地址(RW)
    MBREG_MOTOR_CMD = 40050,            //电机动作命令(W)
    MBREG_MOTOR_RESET,                  //电机电机复位(W)
    MBREG_MOTOR_TARGETSPEED_POS,        //电机运行到目标位置(W)
    MBREG_MOTOR_FDBKPOS_ZERO,           //电机设置当前位置为零位(W)
    MBREG_MOTOR_RPM,                    //电机速度(RW)
    MBREG_MOTOR_FDBKPOS,                //电机当前高度(R)
    MBREG_MOTOR_STATE,                  //电机状态(R)
	MBREG_MOTOR_CLR_FAULT,				//清除电机错误(W)
}MODBUS_REG_t;

/*modbus接口电机控制命令*/
typedef enum
{
	e_mmc_none = 0,
	e_mmc_up,
	e_mmc_dn,
	e_mmc_stop,
    e_mmc_reset,
	e_mmc_clrfault,
	e_mmc_goto,
    e_mmc_poszero,
}mod_m_cmd_t;
 

/*modbus类型定义*/
typedef struct
{
    uint8_t     Interface;  /*数据接口索引*/
    QUEUE_t     *QSend;     /*数据发送队列*/
    uint8_t     State;      /*消息控制器状态*/
    uint8_t     Slave_Flag;
}MSG_HANDLER_t;

/*modbus寄存器键值对索引表*/
MB_REG_KVP_t g_KVPTable[] =
{
    {MBREG_MOTOR_SLAVE_ADDR, 0},
    {MBREG_MOTOR_CMD, 0},
    {MBREG_MOTOR_RESET, 0},
    {MBREG_MOTOR_TARGETSPEED_POS, 0},
    {MBREG_MOTOR_FDBKPOS_ZERO, 0},
    {MBREG_MOTOR_RPM, 0},
    {MBREG_MOTOR_FDBKPOS, 0},
    {MBREG_MOTOR_STATE, 0},
	{MBREG_MOTOR_CLR_FAULT, 0},
    //无效寄存器值(暂定0xFFFF),作为索引表结束标志,必须放在结尾.
    {0xFFFF, 0},
};



/*CAN接口消息反馈*/
//电机运行状态
typedef enum
{
	e_cms_stop = 0,
	e_cms_up = 0x01,
	e_cms_dn = 0x10,
}can_m_sta_t;

//控制器状态
typedef enum
{
	e_css_normal = 1,
	e_css_fault_ovc = 21,
	e_css_fault_hall = 27,
	e_css_fault_hot = 213,
	e_css_fault_udv = 221,
	e_css_fault_ovv = 222,
	e_css_lost_pos = 255,
}can_sys_sta_t;    


/*系统按键状态定义*/
typedef enum
{
    E_SYS_STATE_INIT = 0,       //上电初始化
    E_SYS_STATE_ZERO,     		//设置零位
    E_SYS_STATE_IDLE,           //空闲无动作
    E_SYS_STATE_MOTOR_RUN,      //电机运行
    E_SYS_STATE_MOTOR_GOTOPOS,  //电机自动运行到固定位置(复位后)
    E_SYS_STATE_FAULT,          //系统故障
    E_SYS_STATE_SETTINGS,       //设置记忆位置
    E_SYS_STATE_SETZEROPOS,     //设置当前位置为零位
	E_SYS_CONFIG_INIT,			//配置初始化
    SYSTEM_STATE_NB,
}SYS_STATE_t;

/*系统状态处理函数*/
typedef void (*FP_t)(void*);

/*记忆设置定义*/
typedef enum
{
    E_READY_TO_SET = 0,
    E_SET_MEMORY_POS_1,
    E_SET_MEMORY_POS_2,
    E_SET_MEMORY_POS_3,
    E_SET_MEMORY_POS_4,
//  E_SET_TOP_LIMIT_POS,
//  E_SET_BTM_LIMIT_POS,
//  E_CANCEL_LIMIT_POS,
}SETPOS_TYPE_t;

/*系统工作状态结构体定义*/
typedef struct
{
    float           ModbusColumnPos;    //推杆目标位置
    uint8_t     	MotorMoveCmd;       //电机动作命令      modbus为什么没有这个变量  
    /*控制输入信号*/
    uint8_t     	MCMode;             //0:开环  1:速度闭环   2:速度位置闭环
    uint8_t     	MSRMode;            //0:PWM信号调速     1:AD信号调速
    uint8_t     	ComMode;            //0:485接口           1:MODBUS接口
    uint8_t     	MotorDirSignal;     //0:正转          1:反转
    /*系统状态*/
    SYS_STATE_t 	State;              //当前状态
    uint8_t     	Step;               //当前状态子步骤
    /*母线电压*/
    uint16_t    	BusVoltageMV;
    /*电机控制相关标志*/
    int32_t     	RunDir;             //电机升降方向
//    uint8_t     	MotorMoveCmd;       //电机动作命令
    MOTOR_SPD_t 	MotorSpeed;         //推杆闭环目标速度
    uint16_t    	MotorDC;            //推杆开环目标占空比
    uint16_t    	LimitFlag;          //限位标志
    uint16_t    	MotorFlag;          //电机动作标志
    /*系统标志*/
    uint8_t     	MemoryPosSetFlag;   //已设置的记忆位置标志
    uint16_t    	FaultFlag;          /*系统异常标志*/
    uint8_t			SaveIntoFlash;      /*Flash存取标志*/
    uint8_t     	ZeroFound;          /*已找到过零位标志*/
	uint8_t			HandControlling;	/*手动控制生效标志*/
	uint8_t			ResetHandControlling;/*复位手控标志*/
	mod_m_cmd_t		ModbusCmd;			/*Modbus通讯控制-命令*/
	can_m_cmd_t		CanCmd;				/*Can通讯控制-命令*/
    /*运行到目标位置*/
    MOTOR_POS_t 	GotoHallPos;
    /*推杆位置(单位: mm)*/
    float       	ColumnPosMM[MOTOR_NB];          //推杆当前位置
    float       	ColumnSpcPosMM[COLUMN_POS_NB];  //推杆指定位置
    /*手控器显示控制*/
    uint8_t     	HSSendTimer;
	SYSTEM_CONFIG_t SysCon;
	/*控制器配置时间*/
	uint16_t 		CfgCount;
	/* 过压标志位和过压计数值 */
	uint8_t			OVVFlag;
	uint16_t		OVVCount;
	/* 掉电保存flash标志 */
	uint16_t		PowerDownSaveFlash;
	/* 上电复位标志位 */
	uint8_t 		PowerOnResetFlag;
	uint8_t			MotorLockedRotor;    
}SYSTEM_t;

/*刹车状态结构体定义*/
float Brake_Store_Pos; //刹车过流时推杆已存储的位置
float Current_Pos;//刹车过流时推杆实时的位置
float Brake_Pos_1;//机械距离1mm
uint8_t Brake_State;  //刹车状态  // 1 下限位和记忆点之间；2 上限位和记忆点之间；
uint8_t Brake_Fail_Flag; //  刹车失灵
uint16_t receive_ceiling_switch = 0;//到达上限位开关
uint16_t receive_bottom_switch = 0;//到达下限位开关
uint16_t receive_ceiling_flag = 0;
uint16_t receive_bottom_flag = 0;
uint8_t First_OVC_Flag = 0;//首次过流存位置
/*****************************函数声明(私有)**********************************
*
*备注: 本文件中,不希望被外部调用的函数统一在这里声明
*
*****************************************************************************/
static void system_Init_Handler(void*);
static void system_FindZero_Handler(void*);
static void system_Idle_Handler(void*);
static void system_MotorRun_Handler(void*);
static void system_MotorGotoPos_Handler(void*);
static void system_Fault_Handler(void*);
static void system_Settings_Handler(void*);
static void system_SetZeroPos_Handler(void*);
static void system_ConfigInit_Handler(void*);

static void system_CB_CanOpenSdoTx(uint8_t Index);
void system_FSM_StateJump(SYSTEM_t* pSystem, SYS_STATE_t NextState);
float system_Hall_PER_MM(void);
uint16_t system_Get_Fault(uint16_t FaultMask);
/********************************变量定义*************************************
*
*备注: 不要在.h中定义变量,防止多个.c包含这个.h,导致编译后报错变量重复定义
*
*****************************************************************************/
uint32_t    g_Counter = 0;
uint16_t    g_SwdtCounter = 0;

/*系统状态机子状态函数指针(函数顺序须和SYS_STATE_t中状态顺序一致)*/
FP_t SystemStateHandler[SYSTEM_STATE_NB] =
{
    system_Init_Handler,
    system_FindZero_Handler,
    system_Idle_Handler,
    system_MotorRun_Handler,
    system_MotorGotoPos_Handler,
    system_Fault_Handler,
    system_Settings_Handler,
    system_SetZeroPos_Handler,
	system_ConfigInit_Handler,
};


SYSTEM_t 					System;
ADC_CH_CTRL_t   			hADCChannalMSR; //马达速度调节旋钮模拟采样

ADC_CH_CTRL_t   			hADCChannalTemp;//温度采样



MSG_HANDLER_t   			hMsgHandler[1];
MB_CTRL_t       			hModbusLink;
UART_CTRL_t     			hUartRS485;    

CAN_CTRL_t					hCANController;	//CAN控制器
co_node_t					sCONode;		//CANOpen节点  
extern uint32_t 			CODict_Index2000[20];  

UART_CTRL_t     			hUartReserved;    
syscon_uart_cfg_handle_t	hUartData;

//UART_CTRL_t       hUartHS;    //手控器串口用于显示

/********************************函数定义************************************
*函数名:

*函数功能描述: 系统功能-推杆位置计算

*函数参数: 无

*函数返回值: 无

*备注:
*****************************************************************************/
/*转换: 推杆速度mm/s->电机转速rpm*/
MOTOR_SPD_t system_ColumnSpeed_2_MotorRPM(float Speed_mmps)    //mm/s
{
    MOTOR_SPD_t TargetRPM = 0;
    float TargetRPS_f = 0;	//电机转速/s

    TargetRPS_f = Speed_mmps * (System.SysCon.Sys_GearRatio) / (System.SysCon.Sys_Lead);
    TargetRPM = (MOTOR_SPD_t)(TargetRPS_f * 60);
    return TargetRPM;
}
/*转换: 电机转速rpm->推杆速度mm/s*/
float system_MotorRPM_2_ColumnSpeed(MOTOR_SPD_t MotorRpm)
{
    float ColumnSpd_mmps = 0;

	ColumnSpd_mmps = (float)MotorRpm * (System.SysCon.Sys_Lead) / (System.SysCon.Sys_GearRatio);
	ColumnSpd_mmps = ColumnSpd_mmps / 60;
    return ColumnSpd_mmps;
}
/*修改推杆速度*/
MOTOR_SPD_t system_Modify_Column_Speed(uint8_t Column, float Speed_mmps)    //mm/s
{
    MOTOR_SPD_t TargetRPM = 0;

	TargetRPM = system_ColumnSpeed_2_MotorRPM(Speed_mmps);
    mc_app_Write_Param((1<<Column), e_map_targetspd, TargetRPM);
    return TargetRPM;
}
/*设置推杆特定位置*/
void system_Set_Column_SpecificPos(uint8_t ColumnPosIndex, float ColumnSpcPosMM)
{
    //assert(ColumnPosIndex < COLUMN_POS_NB);

    System.ColumnSpcPosMM[ColumnPosIndex] = ColumnSpcPosMM;
}
/*获取推杆特定位置*/
float system_Get_Column_SpecificPos(uint8_t ColumnPosIndex)
{
    //assert(ColumnPosIndex < COLUMN_POS_NB);

    return System.ColumnSpcPosMM[ColumnPosIndex];
}
/*转换: 推杆行程mm->电机HALL计数值*/
MOTOR_POS_t system_Column_Pos_2_HallData(float ColumnSpcPosMM)
{
    MOTOR_POS_t MotorHallData = 0;
    float   HallsPerMM = system_Hall_PER_MM();

    MotorHallData = (MOTOR_POS_t)(ColumnSpcPosMM * HallsPerMM) + BTM_POS_HALLDATA;
    return MotorHallData;
}
/*转换: 电机HALL计数值->推杆行程mm*/
float system_Column_HallData_2_Pos(MOTOR_POS_t MotorHallData)
{
    float ColumnSpcPosMM = 0;
    float HallsPerMM = system_Hall_PER_MM();

    if(MotorHallData > BTM_POS_HALLDATA)
    {
        ColumnSpcPosMM = (float)(MotorHallData - BTM_POS_HALLDATA) / HallsPerMM;
        return ColumnSpcPosMM;
    }
    return 0;
}
/*获取推杆行程位置(1=0.1mm)*/
float system_Get_Column_CurrentPos(uint8_t Column)
{
    int32_t ReadMotorParam = 0;

    if(mc_app_Read_Param((1<<Column), e_map_fdbkpos, &ReadMotorParam))
    {
        return system_Column_HallData_2_Pos(ReadMotorParam);
    }
    return NAN;
}
/*推杆位置更新*/
void system_Column_Update_Pos_Signal(void)
{
	if((System.SysCon.Sys_CommunicationType == E_MODBUS)||(System.SysCon.Sys_CommunicationType == E_NOCOM))
	{
     if(System.State == E_SYS_STATE_ZERO || SYSTEM_GET_FLAG(System.FaultFlag, FAULT_POS))
		System.ColumnPosMM[0] = 0;
	else
		System.ColumnPosMM[0] = system_Get_Column_CurrentPos(0);
	}
	if(System.SysCon.Sys_CommunicationType == E_CAN)
	{
		if(!System.ZeroFound)
		{
			System.ColumnPosMM[0] = 0;
			gpio_adapter_Reset_Pin(AT_TOP_GPIO_Port, AT_TOP_Pin);
			gpio_adapter_Reset_Pin(AT_BTM_GPIO_Port, AT_BTM_Pin);
		}else
		{
			//位置更新
			System.ColumnPosMM[0] = system_Get_Column_CurrentPos(0);

		}
		
	}
	//输出限位信号(基于推杆限位开关信号)
	if(SYSTEM_GET_FLAG(System.LimitFlag, M1_TOP))
		gpio_adapter_Set_Pin(AT_TOP_GPIO_Port, AT_TOP_Pin);
	else
		gpio_adapter_Reset_Pin(AT_TOP_GPIO_Port, AT_TOP_Pin);
	
	if(SYSTEM_GET_FLAG(System.LimitFlag, M1_BTM))
		gpio_adapter_Set_Pin(AT_BTM_GPIO_Port, AT_BTM_Pin);
	else
		gpio_adapter_Reset_Pin(AT_BTM_GPIO_Port, AT_BTM_Pin);
}
/********************************函数定义************************************
*函数名:

*函数功能描述: 系统功能-电机相关功能

*函数参数: 无

*函数返回值: 无

*备注:
*****************************************************************************/
/*电机停止判断*/
BOOL system_Is_Motor_Stop(uint16_t Motor)
{
    BOOL Ret = TRUE;
    if(Motor & MOTOR1)
    {
        if(mc_app_Get_State(MOTOR1) != e_mas_idle)
            Ret = FALSE;
        else
            SYSTEM_CLR_FLAG(System.MotorFlag, M1_MOVE);
    }
    if(Motor & MOTOR2)
    {
        if(mc_app_Get_State(MOTOR2) != e_mas_idle)
            Ret = FALSE;
        else
            SYSTEM_CLR_FLAG(System.MotorFlag, M2_MOVE);
    }
    return Ret;
}
/*电机执行单电机动作*/
void system_Motor_Move(uint16_t Motor, mc_app_cmd_t Cmd, int32_t argv)
{
    uint16_t MoveFlag = 0;
    if(Cmd != e_mac_start_closeloop && Cmd != e_mac_start_openloop)
        return;
    if(argv == DIR_UP)
        MoveFlag = M1_UP;
    else
        MoveFlag = M1_DOWN;
    if(Motor & MOTOR1)
    {
        mc_app_Set_Single_Motor_Cmd(MOTOR1, Cmd, argv);
        SYSTEM_SET_FLAG(System.MotorFlag, MoveFlag);
    }
    if(Motor & MOTOR2)
    {
        mc_app_Set_Single_Motor_Cmd(MOTOR2, Cmd, argv);
        SYSTEM_SET_FLAG(System.MotorFlag, MoveFlag << 1);
    }
}
/*电机执行单电机斜坡停止*/
void system_Motor_Ramp_Stop(uint16_t Motor, mc_app_cmd_t Cmd)
{
    if(Cmd != e_mac_stop_closeloop && Cmd != e_mac_stop_openloop)
        return;
    if(Motor & MOTOR1)
    {
        mc_app_Set_Single_Motor_Cmd(MOTOR1, Cmd, 0);
    }
    if(Motor & MOTOR2)
    {
        mc_app_Set_Single_Motor_Cmd(MOTOR2, Cmd, 0);
    }
}
/*电机执行单电机停止*/
void system_Motor_Stop(uint16_t Motor)
{
    if(Motor & MOTOR1)
    {
        mc_app_Set_Single_Motor_Cmd(MOTOR1, e_mac_stop, 0);
        SYSTEM_CLR_FLAG(System.MotorFlag, M1_MOVE);
    }
    if(Motor & MOTOR2)
    {
        mc_app_Set_Single_Motor_Cmd(MOTOR2, e_mac_stop, 0);
        SYSTEM_CLR_FLAG(System.MotorFlag, M2_MOVE);
    }
}
/*清除电机运行时异常*/
void system_Clear_Motor_Fault(uint16_t Motor)
{
    if(Motor & MOTOR1)
    {
		SYSTEM_CLR_FLAG(System.FaultFlag, FAULT_M1_ALL);
		mc_app_Write_Param(MOTOR1, e_map_fault, 0);
    }
    if(Motor & MOTOR2)
    {
        SYSTEM_CLR_FLAG(System.FaultFlag, FAULT_M2_ALL);
        mc_app_Write_Param(MOTOR2, e_map_fault, 0);
    }
}
/*电机运行时保护*/
void system_Motor_Protect(void)
{
    int32_t MFault[4] = {0};

    mc_app_Read_Param(MOTOR1, e_map_fault, &MFault[0]);
    mc_app_Read_Param(MOTOR2, e_map_fault, &MFault[1]);
    if(MFault[0] & MOTOR_FAULT_OVC)
        SYSTEM_SET_FLAG(System.FaultFlag, FAULT_M1_OVC);
    if(MFault[0] & MOTOR_FAULT_HALL)
        SYSTEM_SET_FLAG(System.FaultFlag, FAULT_M1_HAB);
    if(MFault[1] & MOTOR_FAULT_OVC)
        SYSTEM_SET_FLAG(System.FaultFlag, FAULT_M2_OVC);
    if(MFault[1] & MOTOR_FAULT_HALL)
        SYSTEM_SET_FLAG(System.FaultFlag, FAULT_M2_HAB);
}
/*电机任务*/
void system_Motor_Task(void)
{
    /*电机控制*/
    mc_app_Loop_Task();

    /*电机运行时保护*/
    system_Motor_Protect();
}

/********************************函数定义************************************
*函数名:

*函数功能描述: 系统配置功能

*函数参数: 无

*函数返回值: 无

*备注:
*****************************************************************************/
/* 推杆参数初始化*/
void system_Motor_Init(SYSTEM_t* System)
{
	SYSTEM_t* pSystem = System;
	syscon_cfg_handle_t hSystemConfig = sys_cfg_Hadnle();
    
	/*推杆参数*/
	pSystem->SysCon.Sys_GearRatio = ((float)hSystemConfig.Config_GearRatio / 1000);                 //齿轮减速比
	pSystem->SysCon.Sys_Lead = (float)hSystemConfig.Config_Lead;                                    //丝杆导程           
	pSystem->SysCon.Sys_Route = (float)hSystemConfig.Config_Route;                                  //行程
	pSystem->SysCon.Sys_SpeedMmps = ((float)hSystemConfig.Config_SpeedMmps/10);                     //推杆速度
	
	pSystem->SysCon.Sys_OvcValue = hSystemConfig.Config_OvcValue;                                   //过流保护阈值
	pSystem->SysCon.Sys_OverVoltage = ((float)hSystemConfig.Config_OverVoltage/10);                 //过压保护阈值
	pSystem->SysCon.Sys_UnderVoltage = ((float)hSystemConfig.Config_UnderVoltage/10);               //欠压保护阈值
	
	
	/*系统参数初始化*/	
	pSystem->SysCon.Sys_NodeSlaveAddr = hSystemConfig.Config_NodeSlaveAddr;                         //通讯节点ID
	pSystem->SysCon.Sys_CommunicationType = (syscon_cfg_com_type_t)hSystemConfig.Config_CommunicationType;  //通讯类型

	pSystem->SysCon.Sys_DIFunction = (syscon_cfg_di_fun_t)hSystemConfig.Config_DIFunction;          //引脚输入功能
	pSystem->SysCon.Sys_DOFunction = (syscon_cfg_do_fun_t)hSystemConfig.Config_DOFunction;          //引脚输出功能
	pSystem->SysCon.Sys_ActiveValue = (syscon_cfg_pin_polarity_t)hSystemConfig.Config_ActiveValue;  //引脚极性
	
	pSystem->SysCon.Sys_ResetRaise = (float)hSystemConfig.Config_ResetRaise;                        //复位抬高
	pSystem->SysCon.Sys_ResetRunMode = (syscon_cfg_reset_run_mode_t)hSystemConfig.Config_ResetRunMode;      //复位运行模式
	pSystem->SysCon.Sys_ResetDirection = (syscon_cfg_reset_direction_t)hSystemConfig.Config_ResetDirection; //复位方向
	pSystem->SysCon.Sys_ResetMode = (syscon_cfg_reset_judgment_mode_t)hSystemConfig.Config_ResetMode;       //复位判断方式
	pSystem->SysCon.Sys_MotorRunMode = (syscon_cfg_motor_run_mode_t)hSystemConfig.Config_MotorRunMode;      //电机运行模式
	
	pSystem->SysCon.Sys_TopDetection = (syscon_cfg_top_detect_t)hSystemConfig.Config_TopDetection;  //到顶检测
	pSystem->SysCon.Sys_BtmDetection = (syscon_cfg_btm_detect_t)hSystemConfig.Config_BtmDetection;  //到底检测
	
}

/*不同通讯方式初始化电机参数*/
void system_Communication_Motor_Init(void)
{
    uint32_t Data[10] = {0};
	uint32_t Check = 0;
	float ColumnSpdMMPS = 0;
    if((System.SysCon.Sys_CommunicationType != E_MODBUS)&&(System.SysCon.Sys_CommunicationType != E_CAN))
        return;
    if(System.SysCon.Sys_CommunicationType == E_MODBUS)
    {
        /*初始化掉电存储的电机控制参数*/
        flash_adapter_Read(WORD, FSA_SYS_PARAM, WORD, Data, 3);
        if(Data[0] == 0xAA55)
        {
            Check = Data[0] + Data[1];
            if(Check == Data[2])
            {
                hModbusLink.SlaveAddr = Data[1];
            }
        }
    }else if(System.SysCon.Sys_CommunicationType == E_CAN)
    {
        /*CanOpen对象字典初始化*/
        CO_SET_OD(OD_SI_VERSION, SW_VERSION);
        CO_SET_OD(OD_SI_MINIVERSION, SW_MINI_VERSION);
        CO_SET_OD(OD_SI_TRG_SPD, (uint32_t)(System.SysCon.Sys_SpeedMmps * 10));
        CO_SET_OD(OD_SI_HEARTBEAT, DEFAULT_HEART_BEAT);
        CO_SET_OD(OD_SI_NODEID, System.SysCon.Sys_NodeSlaveAddr);
        CO_SET_OD(OD_SI_BAUDRATE, 2);	//0-1M, 1-500k, 2-250k, 3-125k(暂未实现修改波特率的功能)
        System.CanCmd = e_can_none;
        
        /*初始化掉电存储的电机控制参数*/
        flash_adapter_Read(WORD, FSA_SYS_PARAM, WORD, Data, 5);
        if(Data[0] == 0xAA55)
        {
            Check = Data[0] + Data[1] + Data[2] + Data[3];
            if(Check == Data[4])
            {
                ColumnSpdMMPS = (float)Data[1] / 10.0f;		//flash和对象字典中存储的速度单位:1=0.1mm/s
                System.MotorSpeed = system_Modify_Column_Speed(0, ColumnSpdMMPS);
                sCONode.HeartBeatMs = Data[2];
                sCONode.NodeID = Data[3];
                CO_SET_OD(OD_SI_TRG_SPD, Data[1]);
                CO_SET_OD(OD_SI_HEARTBEAT, Data[2]);
                CO_SET_OD(OD_SI_NODEID, Data[3]);
            }
        }

        /*CAN滤波器设置*/
        //	can_adapter_SetFilter_IDMask(CAN1, CanFilterSel1, 0, 0x1FFFFFFF);	//所有ID都接收(仅调试用)
        can_adapter_SetFilter_ID(CAN1, CanFilterSel1, 0);	//永远接收ID == 0的帧(仅调试用)
        can_adapter_SetFilter_IDMask(CAN1, CanFilterSel2, sCONode.NodeID, CO_ID_MASK_FUNC);
    }
}

/*电机的复位判断方式*/
void system_Reset_Noreset(SYSTEM_t* pSys)
{
    if((System.SysCon.Sys_ResetMode != E_DETECTION_SIGNAL)&&(System.SysCon.Sys_ResetMode != E_DETECTION_ANOMALY))
    {
        return;
    }
    if(System.SysCon.Sys_ResetMode == E_DETECTION_SIGNAL)
    {
		System.ZeroFound = 0;
		SYSTEM_SET_FLAG(pSys->SaveIntoFlash, FS_MOTOR_SATE);  
        system_FSM_StateJump(pSys, E_SYS_STATE_FAULT);
    }else if(System.SysCon.Sys_ResetMode == E_DETECTION_ANOMALY)
    {
        SYSTEM_SET_FLAG(pSys->FaultFlag, FAULT_POS);
		SYSTEM_SET_FLAG(pSys->SaveIntoFlash, FS_MOTOR_SATE);
		System.PowerOnResetFlag = 1;
        system_FSM_StateJump(pSys, E_SYS_STATE_FAULT);   
    }
}

/*电机复位模式*/
BTN_STATE_t syste_Reset_Mode(void)
{
    if((System.SysCon.Sys_ResetDirection != E_RESET_BTM)&&(System.SysCon.Sys_ResetDirection != E_RESET_TOP))
    {
        return E_BTN_STA_UNDEFINED;
    }
    if(System.SysCon.Sys_ResetDirection == E_RESET_BTM)
    {
        return btn_Get_State(KEY_MOTOR_DOWN);
    }else if(System.SysCon.Sys_ResetDirection == E_RESET_TOP)
    {
        return btn_Get_State(KEY_MOTOR_UP);
    }
	return E_BTN_STA_UNDEFINED;
}

/*判断复位方向*/
bool system_Reset_Direction(SYSTEM_t* pSys)
{
	bool Ret = 0;
    if(((System.SysCon.Sys_ResetDirection != E_RESET_BTM)&&(System.SysCon.Sys_ResetDirection != E_RESET_TOP))\
        ||((System.SysCon.Sys_CommunicationType != E_MODBUS)&&(System.SysCon.Sys_CommunicationType != E_CAN)\
		&&(System.SysCon.Sys_CommunicationType != E_NOCOM)))
    {
        return 0;
    }
    if(System.SysCon.Sys_ResetDirection == E_RESET_BTM)
    {
		if(btn_Match_Event(KEY_MOTOR_DOWN, E_BTN_EVT_PRESS, 0))
		{
			system_Clear_Motor_Fault(MOTOR1);   //清错误的原因: 复位暂停如果采用慢停止,可能会堵转,产生报错.
			System.ResetHandControlling = 1;
			Ret = 1;
		}
    }else  if(System.SysCon.Sys_ResetDirection == E_RESET_TOP)
    {
        if(btn_Match_Event(KEY_MOTOR_UP, E_BTN_EVT_PRESS, 0))
		{
			system_Clear_Motor_Fault(MOTOR1);   //清错误的原因: 复位暂停如果采用慢停止,可能会堵转,产生报错.
			System.ResetHandControlling = 1;
			Ret = 1;
		}
    }
    if(System.SysCon.Sys_CommunicationType == E_MODBUS)
    {
        /*modbus协议-复位方式*/
        if( pSys->ModbusCmd == e_mmc_reset)
        {
            pSys->ModbusCmd = e_mmc_none;
            system_Clear_Motor_Fault(MOTOR1);   //清错误的原因: 复位暂停如果采用慢停止,可能会堵转,产生报错.
            System.ResetHandControlling = 0;
			Ret = 1;
        }
        
    }
    else if(System.SysCon.Sys_CommunicationType == E_CAN)
    {
         /*modbus协议-复位方式*/
        if( pSys->CanCmd == e_can_reset)
        {
            pSys->CanCmd = e_can_none;
            system_Clear_Motor_Fault(MOTOR1);   //清错误的原因: 复位暂停如果采用慢停止,可能会堵转,产生报错.
            System.ResetHandControlling = 0;
			Ret = 1;
        }
    }
    
	return Ret;
}

/*复位启动*/
bool system_Reset_Start(void)
{
	bool Ret = 0;
    if((System.SysCon.Sys_ResetDirection != E_RESET_BTM)&&(System.SysCon.Sys_ResetDirection != E_RESET_TOP))
    {
        return 0;
    }
    if(system_Is_Motor_Stop(MOTOR1))
    {
        if(System.SysCon.Sys_ResetDirection == E_RESET_BTM)
        {
            system_Motor_Move(MOTOR1, e_mac_start_closeloop, DIR_DOWN);
        }else if(System.SysCon.Sys_ResetDirection == E_RESET_TOP)
        {
            system_Motor_Move(MOTOR1, e_mac_start_closeloop, DIR_UP);
        }
        Ret = 1;
    }
	return Ret;
}

/*复位检测的方式*/
bool system_Reset_Detection_Mode(SYSTEM_t* pSys)
{
	bool Ret = 0;
    static float g_ZeroPosHall;
    if((System.SysCon.Sys_ResetDirection != E_RESET_BTM)&&(System.SysCon.Sys_ResetDirection != E_RESET_TOP))
    {
        return 0;
    }
    if(mc_app_Get_State(MOTOR1) == e_mas_idle)
    {
        if(SYSTEM_GET_FLAG(pSys->FaultFlag, FAULT_M1_HAB | FAULT_M1_OVC))    //过流和hall异常都可能是到底堵转
        {
            system_Clear_Motor_Fault(MOTOR1);   //清错误的原因: 防止和回零状态的全局故障判断冲突,导致系统进入FAULT状态.
            if(System.SysCon.Sys_ResetDirection == E_RESET_BTM)
            {
                SYSTEM_CLR_FLAG(pSys->MotorFlag, M1_DOWN);
                g_ZeroPosHall = BTM_POS_HALLDATA;
            }else if(System.SysCon.Sys_ResetDirection == E_RESET_TOP)
            {
                SYSTEM_CLR_FLAG(pSys->MotorFlag, M1_UP);
                g_ZeroPosHall = system_Column_Pos_2_HallData(System.SysCon.Sys_Route);
            }
        }
    }
    if(SYSTEM_MATCH_FLAG(pSys->MotorFlag, 0))
    {
        /*电机控制参数恢复*/
        for(uint8_t i = 0; i< SYS_MOTOR_NB; i++)
        {
            mc_app_Write_Param((MOTOR1<<i), e_map_drvoutput_max, (PWM_OUTPUT_FULLSCALE / 100) * MAX_PWM_PERCENT);//抬高最大占空比要给最大值,防止负载抬不起来
            mc_app_Write_Param((MOTOR1<<i), e_map_fdbkpos, g_ZeroPosHall);
        }
        Ret = 1;
    }
	return Ret;
}

/*复位后的初始位置*/
bool system_Reset_Initial_Position(void)
{
	bool Ret = 0;
    MOTOR_POS_t TargetHallPos = 0;
    if(((System.SysCon.Sys_ResetDirection != E_RESET_BTM)&&(System.SysCon.Sys_ResetDirection != E_RESET_TOP))\
        ||(System.SysCon.Sys_ResetRaise<(-100))||(System.SysCon.Sys_ResetRaise>100))
    {
        return 0;
    }
    if((mc_app_Get_State(MOTOR1) == e_mas_idle)&&(System.SysCon.Sys_ResetRaise != 0))
    {
        if(System.SysCon.Sys_ResetDirection == E_RESET_BTM)
        {
            TargetHallPos = (MOTOR_POS_t)((system_Hall_PER_MM()) * (BTM_POS_HALLDATA + System.SysCon.Sys_ResetRaise));   
//			TargetHallPos = (BTM_POS_HALLDATA + (System.SysCon.Sys_ResetRaise));
		}else if(System.SysCon.Sys_ResetDirection == E_RESET_TOP)
        {
            TargetHallPos = (MOTOR_POS_t)((system_Hall_PER_MM()) * (System.SysCon.Sys_Route + System.SysCon.Sys_ResetRaise));   
//			TargetHallPos = (System.SysCon.Sys_Route + (System.SysCon.Sys_ResetRaise)); 
		}
        mc_app_Set_Single_Motor_Cmd(MOTOR1, e_mac_goto_targetpos, TargetHallPos);	/* 抬高降低的是hall值，需要将MM转换为HALL */
    }else
    {
        Ret = 1;
    }
	return Ret;
}

/* 复位的运行模式*/
bool system_Reset_Run_Mode(BTN_STATE_t ResetState)
{
	bool Ret = 0;
    if(((System.SysCon.Sys_ResetRunMode != E_RESET_INCHING)&&(System.SysCon.Sys_ResetRunMode != E_RESET_CONTINUOUS))\
        ||((System.SysCon.Sys_ResetDirection != E_RESET_BTM)&&(System.SysCon.Sys_ResetDirection != E_RESET_TOP))\
        ||(ResetState == E_BTN_STA_UNDEFINED))
    {
        return 0;
    }
    if(System.SysCon.Sys_ResetRunMode == E_RESET_CONTINUOUS)
    {
        /*续动-再次按下复位键停止复位*/
        if(System.SysCon.Sys_ResetDirection == E_RESET_BTM)
        {
            if(btn_Match_Event(KEY_MOTOR_DOWN, E_BTN_EVT_PRESS, 0))
            {
                Ret = 1;
            }
        }else if(System.SysCon.Sys_ResetDirection == E_RESET_TOP)
        {
            if(btn_Match_Event(KEY_MOTOR_UP, E_BTN_EVT_PRESS, 0))
            {
                Ret = 1;
            }
        }
    }else if(System.SysCon.Sys_ResetRunMode == E_RESET_INCHING)
    {
		if(System.ResetHandControlling == 1)
		{
			/*点动-松开复位键停止复位*/
			if(ResetState == E_BTN_STA_RELEASED)
			{
				Ret = 1;
			}
		}
        
    }
	return Ret;
}

/*电机的运行模式*/
bool system_Motor_Run_Mode(BTN_STATE_t MUState, BTN_STATE_t MDState)
{
	bool Ret = 0;
    if(((System.SysCon.Sys_MotorRunMode != E_MOTOR_INCHING)&&(System.SysCon.Sys_MotorRunMode != E_MOTOR_CONTINUOUS))\
        || (MUState == E_BTN_STA_UNDEFINED)||(MDState == E_BTN_STA_UNDEFINED))
    {
        return 0;
    }
    if(System.SysCon.Sys_MotorRunMode == E_MOTOR_INCHING)
    {
		if(System.HandControlling == 1)
		{
			/*点动-按键松手电机停下*/
			if((MUState == E_BTN_STA_RELEASED && System.RunDir == DIR_UP) || \
				(MDState == E_BTN_STA_RELEASED && System.RunDir == DIR_DOWN))
			{
				Ret = 1;
			}
		}
    }else if(System.SysCon.Sys_MotorRunMode == E_MOTOR_CONTINUOUS)
    {
		System.HandControlling = 0;
        /*续动-按键再次按下电机停下*/
        if((btn_Match_Event(KEY_MOTOR_DOWN, E_BTN_EVT_PRESS, 0))||(btn_Match_Event(KEY_MOTOR_UP, E_BTN_EVT_PRESS, 0)))
        {
            Ret = 1;
        }
    }
	return Ret;
}

/*电机空闲上位机运行到目标位置方式*/
void system_Idle_ComGotoPos(SYSTEM_t* pSys)
{
    if((System.SysCon.Sys_CommunicationType != E_MODBUS)&&(System.SysCon.Sys_CommunicationType != E_CAN))
    {
        return;
    }
    if(System.SysCon.Sys_CommunicationType == E_MODBUS)
    {
        /*Modbus通讯-进入运行到目标位置状态*/
        if(pSys->HandControlling == 0)
        {
            if(pSys->ModbusCmd == e_mmc_goto)
            {
                pSys->ModbusCmd = e_mmc_none;
                pSys->GotoHallPos = system_Column_Pos_2_HallData(pSys->ModbusColumnPos);
                system_FSM_StateJump(pSys, E_SYS_STATE_MOTOR_GOTOPOS);
                return;
            }
        }
        if(pSys->ModbusCmd == e_mmc_poszero)
        {
            pSys->ModbusCmd = e_mmc_none;
            system_FSM_StateJump(pSys, E_SYS_STATE_SETZEROPOS);
            return;
        }
    }else if(System.SysCon.Sys_CommunicationType == E_CAN)
    {
        /*CAN通讯-进入运行到目标位置状态*/
        if(pSys->HandControlling == 0)
        {
            if(pSys->CanCmd == e_can_goto)
            {
                pSys->CanCmd = e_can_none;
                pSys->GotoHallPos = system_Column_Pos_2_HallData(CO_GET_OD(OD_SI_CMD_M_GOTO));
                system_FSM_StateJump(pSys, E_SYS_STATE_MOTOR_GOTOPOS);
                return;
            }
        }
    }
}

/*电机上位机启动*/
void system_Idle_ComRun(SYSTEM_t* pSys)
{
	float ColumnPosTop = 0;
    float ColumnPosBtm = 0;
    if((System.SysCon.Sys_CommunicationType != E_MODBUS)&&(System.SysCon.Sys_CommunicationType != E_CAN))
    {
        return;
    }
    if(System.SysCon.Sys_CommunicationType == E_MODBUS)
    {
        if(pSys->ModbusCmd == e_mmc_up)
		{
			pSys->ModbusCmd = e_mmc_none;
			pSys->RunDir = DIR_UP;
			if(System.ZeroFound == 1)
			{
				ColumnPosTop = system_Get_Column_SpecificPos(COLUMN_POS_SET_TOP);
				pSys->GotoHallPos = system_Column_Pos_2_HallData(ColumnPosTop);
				system_FSM_StateJump(pSys, E_SYS_STATE_MOTOR_GOTOPOS);
				return;
			}
			system_FSM_StateJump(pSys, E_SYS_STATE_MOTOR_RUN);
			return;
		}else if(pSys->ModbusCmd == e_mmc_dn)
		{
			pSys->ModbusCmd = e_mmc_none;
			pSys->RunDir = DIR_DOWN;
			if(System.ZeroFound == 1)
			{
				ColumnPosBtm = system_Get_Column_SpecificPos(COLUMN_POS_ZERO);
				pSys->GotoHallPos = system_Column_Pos_2_HallData(ColumnPosBtm);
				system_FSM_StateJump(pSys, E_SYS_STATE_MOTOR_GOTOPOS);
				return;
			}
			system_FSM_StateJump(pSys, E_SYS_STATE_MOTOR_RUN);
			return;
		}
    }else if(System.SysCon.Sys_CommunicationType == E_CAN)
    {
        if(pSys->CanCmd == e_can_up)
		{
			pSys->CanCmd = e_can_none;
			pSys->RunDir = DIR_UP;
			if(System.ZeroFound == 1)
			{
				ColumnPosTop = system_Get_Column_SpecificPos(COLUMN_POS_SET_TOP);
				pSys->GotoHallPos = system_Column_Pos_2_HallData(ColumnPosTop);
				system_FSM_StateJump(pSys, E_SYS_STATE_MOTOR_GOTOPOS);
				return;
			}
			system_FSM_StateJump(pSys, E_SYS_STATE_MOTOR_RUN);
			return;
		}else if(pSys->CanCmd == e_can_dn)
		{
			pSys->CanCmd = e_can_none;
			pSys->RunDir = DIR_DOWN;
			if(System.ZeroFound == 1)
			{
				ColumnPosBtm = system_Get_Column_SpecificPos(COLUMN_POS_ZERO);
				pSys->GotoHallPos = system_Column_Pos_2_HallData(ColumnPosBtm);
				system_FSM_StateJump(pSys, E_SYS_STATE_MOTOR_GOTOPOS);
				return;
			}
			system_FSM_StateJump(pSys, E_SYS_STATE_MOTOR_RUN);
			return;
		}
    }
}
/*电机空闲启动方式*/
bool system_Idle_Start(SYSTEM_t* pSys, float Columnpos)
{
    float ColumnPosTop = 0;
    float ColumnPosBtm = 0;

    if((System.SysCon.Sys_ResetMode != E_DETECTION_SIGNAL)&&(System.SysCon.Sys_ResetMode != E_DETECTION_ANOMALY))
    {
        return 0;
    }
    if(System.SysCon.Sys_ResetMode == E_DETECTION_SIGNAL)
    {
		if(System.ZeroFound == 1)
		{
			if(pSys->ColumnPosMM[0] + 0.5f < Columnpos)
			{
				if(pSys->RunDir == DIR_UP)
				{
					ColumnPosTop = system_Get_Column_SpecificPos(COLUMN_POS_SET_TOP);
					pSys->GotoHallPos = system_Column_Pos_2_HallData(ColumnPosTop);
					system_FSM_StateJump(pSys, E_SYS_STATE_MOTOR_GOTOPOS);
					return 1;
				}
			}
			if(pSys->ColumnPosMM[0] > Columnpos + 0.5f)
			{
				if(pSys->RunDir == DIR_DOWN)
				{
					ColumnPosBtm = system_Get_Column_SpecificPos(COLUMN_POS_ZERO);
					pSys->GotoHallPos = system_Column_Pos_2_HallData(ColumnPosBtm);
					system_FSM_StateJump(pSys, E_SYS_STATE_MOTOR_GOTOPOS);
					return 1;
				}
				
			}
		}else
		{
			system_FSM_StateJump(pSys, E_SYS_STATE_MOTOR_RUN);
			return 1;
		}
    }else if(System.SysCon.Sys_ResetMode == E_DETECTION_ANOMALY)
    {
		if(pSys->ColumnPosMM[0] + 0.5f < Columnpos)
		{
			if(pSys->RunDir == DIR_UP)
			{
				ColumnPosTop = system_Get_Column_SpecificPos(COLUMN_POS_SET_TOP);
				pSys->GotoHallPos = system_Column_Pos_2_HallData(ColumnPosTop);
				system_FSM_StateJump(pSys, E_SYS_STATE_MOTOR_GOTOPOS);
				return 1;
			}
		}
		if(pSys->ColumnPosMM[0] > Columnpos + 0.5f)
		{
			if(pSys->RunDir == DIR_DOWN)
			{
				ColumnPosBtm = system_Get_Column_SpecificPos(COLUMN_POS_ZERO);
				pSys->GotoHallPos = system_Column_Pos_2_HallData(ColumnPosBtm);
				system_FSM_StateJump(pSys, E_SYS_STATE_MOTOR_GOTOPOS);
				return 1;
			}
			
		}
		
    }
	return 0;
}

/*上位机目标位置更新*/
MOTOR_POS_t system_Communication_Updategotopos(void)
{
    if((System.SysCon.Sys_CommunicationType != E_MODBUS)&&(System.SysCon.Sys_CommunicationType != E_CAN))
    {
        return 0;
    }
    if(System.SysCon.Sys_CommunicationType == E_MODBUS)
    {
        return system_Column_Pos_2_HallData(System.ModbusColumnPos);
    }else if(System.SysCon.Sys_CommunicationType == E_CAN)
    {
        return system_Column_Pos_2_HallData(CO_GET_OD(OD_SI_CMD_M_GOTO));
    }
	return 0;
}

/* 上位机空闲指令*/
void system_Communication_None(void)
{
    if((System.SysCon.Sys_CommunicationType != E_MODBUS)&&(System.SysCon.Sys_CommunicationType != E_CAN))
        return;
    if(System.SysCon.Sys_CommunicationType == E_MODBUS)
    {
        System.ModbusCmd = e_mmc_none;
    }else if(System.SysCon.Sys_CommunicationType == E_CAN)
    {
        System.CanCmd = e_can_none;
    }
}

/*上位机运行到目标位置*/
bool system_Communication_Goto(void)
{
	bool Ret = 0;
    if((System.SysCon.Sys_CommunicationType != E_MODBUS)&&(System.SysCon.Sys_CommunicationType != E_CAN))
        return 0;
    if(System.SysCon.Sys_CommunicationType == E_MODBUS)
    {
        if(System.ModbusCmd == e_mmc_goto)
            Ret = 1;
    }else if(System.SysCon.Sys_CommunicationType == E_CAN)
    {
        if(System.CanCmd == e_can_goto)
            Ret = 1;
    }
	return Ret;
}

/*上位机停止命令*/
bool system_Communication_Stop(void)
{
	bool Ret = 0;
    if((System.SysCon.Sys_CommunicationType != E_MODBUS)&&(System.SysCon.Sys_CommunicationType != E_CAN))
        return 0;
    if(System.SysCon.Sys_CommunicationType == E_MODBUS)
    {
        if(System.ModbusCmd == e_mmc_stop)
            Ret = 1;
    }else if(System.SysCon.Sys_CommunicationType == E_CAN)
    {
        if(System.CanCmd == e_can_stop)
            Ret = 1;
    }
	return Ret;
}

/*上位机上升指令*/
bool system_Communication_Up(void)
{
	bool Ret = 0;
    if((System.SysCon.Sys_CommunicationType != E_MODBUS)&&(System.SysCon.Sys_CommunicationType != E_CAN))
        return 0;
    if(System.SysCon.Sys_CommunicationType == E_MODBUS)
    {
        if(System.ModbusCmd == e_mmc_up)
            Ret = 1;
    }else if(System.SysCon.Sys_CommunicationType == E_CAN)
    {
        if(System.CanCmd == e_can_up)
            Ret = 1;
    }
	return Ret;
}

/*上位机下降指令*/
bool system_Communication_Down(void)
{
	bool Ret = 0;
    if((System.SysCon.Sys_CommunicationType != E_MODBUS)&&(System.SysCon.Sys_CommunicationType != E_CAN))
        return 0;
    if(System.SysCon.Sys_CommunicationType == E_MODBUS)
    {
        if(System.ModbusCmd == e_mmc_dn)
            Ret = 1;
    }else if(System.SysCon.Sys_CommunicationType == E_CAN)
    {
        if(System.CanCmd == e_can_dn)
            Ret = 1;
    }
	return Ret;
}

/* 上位机复位指令*/
bool system_Communication_Reset(void)
{
	bool Ret = 0;
    if((System.SysCon.Sys_CommunicationType != E_MODBUS)&&(System.SysCon.Sys_CommunicationType != E_CAN))
        return 0;
    if(System.SysCon.Sys_CommunicationType == E_MODBUS)
    {
        if(System.ModbusCmd == e_mmc_reset)
		{
			System.ModbusCmd = e_mmc_none;
			System.ResetHandControlling = 0;
            Ret = 1;
		}
    }else if(System.SysCon.Sys_CommunicationType == E_CAN)
    {
		if(System.CanCmd == e_can_reset)
		{
			System.CanCmd =  e_can_none;
			System.ResetHandControlling = 0;
			Ret = 1;
		}
    }
	return Ret;
}


/*判断按键事件*/
bool system_Get_Key_Event(void)
{
	bool Ret = 0;
    if((System.SysCon.Sys_ResetDirection != E_RESET_BTM)&&(System.SysCon.Sys_ResetDirection != E_RESET_TOP))
    {
        return 0;
    }
    if(System.SysCon.Sys_ResetDirection == E_RESET_BTM)
    {
		if(btn_Match_Event(KEY_MOTOR_DOWN, E_BTN_EVT_PRESS, 0))
		{
			System.ResetHandControlling = 1;
			Ret = 1;
		}
    }else if(System.SysCon.Sys_ResetDirection == E_RESET_TOP)
    {
		if(btn_Match_Event(KEY_MOTOR_UP, E_BTN_EVT_PRESS, 0))
		{
			System.ResetHandControlling = 1;
			Ret = 1;
		}
    }
	return Ret;
}

/*长按按键*/
bool system_Get_LongKey(void)
{
	bool Ret = 0;
    if((System.SysCon.Sys_ResetDirection != E_RESET_BTM)&&(System.SysCon.Sys_ResetDirection != E_RESET_TOP))
    {
        return 0;
    }
    if(System.SysCon.Sys_ResetDirection == E_RESET_BTM)
    {
		if(btn_Match_Event(KEY_MOTOR_DOWN, E_BTN_EVT_LONG_PRESS, 1000))
		{
			Ret = 1;
		}
    }else if(System.SysCon.Sys_ResetDirection == E_RESET_TOP)
    {
		if(btn_Match_Event(KEY_MOTOR_UP, E_BTN_EVT_LONG_PRESS, 1000))
		{
			Ret = 1;
		}
    }
	return Ret;
}

/*HALL_PER_MM*/
float system_Hall_PER_MM(void)
{
    return ((System.SysCon.Sys_GearRatio*HPR)/System.SysCon.Sys_Lead);
}


/*推杆最大推速*/
float system_Speedmmps_Max(void)
{
    return ((System.SysCon.Sys_SpeedMmps)*(1+SPEED_INDEX));
}


/* 推杆最小推速*/
float system_Speedmmps_Min(void)
{
    return ((System.SysCon.Sys_SpeedMmps)*(1-SPEED_INDEX));
}

/* 返回到底检测的类型 */
syscon_cfg_btm_detect_t system_CfgBtmDetet(void)
{
	return System.SysCon.Sys_BtmDetection;
}

/* 返回到顶检测的类型 */
syscon_cfg_top_detect_t system_CfgTopDetet(void)
{
	return System.SysCon.Sys_TopDetection;
}

/* 判断电机运行是否运行到信号开关处 */
void system_SignalSwitch(void)
{
	if(system_CfgBtmDetet() == E_BTM_SIGNAL_SWITCH)
	{
		if(System.RunDir == DIR_DOWN && (System.LimitFlag & M1_BTM))
		{
			mc_app_Write_Param(MOTOR1, e_map_fdbkpos, BTM_POS_HALLDATA);//只在电机运行时清零位置,防止开关误触发(客户反馈断24V/5V时会有此现象)
			System.ZeroFound = 1;
		}
	}
	if(system_CfgTopDetet() == E_TOP_SIGNAL_SWITCH)
	{
		if(System.RunDir == DIR_UP && (System.LimitFlag & M1_TOP))
		{
			mc_app_Write_Param(MOTOR1, e_map_fdbkpos, (MOTOR_POS_t)((system_Hall_PER_MM())*System.SysCon.Sys_Route));//只在电机运行时清零位置,防止开关误触发(客户反馈断24V/5V时会有此现象)
			System.ZeroFound = 1;
		}
	}
}

/********************************函数定义************************************
*函数名:

*函数功能描述: 系统功能-系统异常检测任务

*函数参数: 无

*函数返回值: 无

*备注:
*****************************************************************************/
/*过压/欠压保护*/
void system_UDV_OVV_Protect(void)
{
    uint16_t ADData_Voltage = 0;    //输入的模拟量
    float BusVoltage = 0;
    
    // float R1 = VM_R1;  //阻值单位: kΩ
    // float R2 = VM_R2; //分压比 = R1/(R1+R2)

    /*电压采样*/
    if(1 == adc_adapter_SCM_1Ch_Convert(ADCH_VM_ADCH))
    {

        ADData_Voltage = adc_adapter_Get_Channel_Result(ADCH_VM_ADCH);
        BusVoltage = (float)ADData_Voltage * ADC_REF_VOLTAGE / ADC_FULL_SCALE;

        BusVoltage = (BusVoltage*(VM_R1 + VM_R2) / VM_R1) ;

        /*判断是否发生异常*/
        if(BusVoltage > System.SysCon.Sys_OverVoltage)
        {
			System.OVVFlag = 1;
        }else
        {
			System.OVVFlag = 0;
			System.OVVCount = 0;
            if(BusVoltage < (System.SysCon.Sys_OverVoltage - HYSTERESIS_VOLTAGE))    //过压恢复迟滞
                SYSTEM_CLR_FLAG(System.FaultFlag, FAULT_OVV);
        }
        if(BusVoltage < System.SysCon.Sys_UnderVoltage)
        {
            SYSTEM_SET_FLAG(System.FaultFlag, FAULT_UDV);
        }else
        {
            if(BusVoltage > System.SysCon.Sys_UnderVoltage + HYSTERESIS_VOLTAGE) //欠压恢复迟滞
                SYSTEM_CLR_FLAG(System.FaultFlag, FAULT_UDV);
        }
		if(System.OVVCount >= OVV_COUNT_MAX)
		{
			SYSTEM_SET_FLAG(System.FaultFlag, FAULT_OVV);
		}
        System.BusVoltageMV = (uint16_t)(BusVoltage * 1000);
    }
}
/*过热保护*/
void system_OVT_Protect(void)
{
	static uint16_t ADData_Temperature[1];
	float Volatage_85C = 1.69f; //85°C的采样电压值
	float Volatage_45C = 0.64f; //45°C的采样电压值
	float CmpValue = 0;
	static uint8_t CmpEn = 0;

	/*温度采样*/
	if(1 == adc_adapter_SCM_1Ch_Convert(ADCH_TEMP_ADCH))
	{
		ADData_Temperature[0] = adc_adapter_Get_Channel_Result(ADCH_TEMP_ADCH);
		CmpEn |= 0x01;
	}
	/*判断是否发生异常*/
	if(CmpEn == 0x01)
	{
		CmpValue = Volatage_85C * ADC_FULL_SCALE / ADC_REF_VOLTAGE;
		if(ADData_Temperature[0] > (uint16_t)CmpValue)
		{
			SYSTEM_SET_FLAG(System.FaultFlag, FAULT_OVT);
		}
		CmpValue = Volatage_45C * ADC_FULL_SCALE / ADC_REF_VOLTAGE;
		if(ADData_Temperature[0] < (uint16_t)CmpValue)
		{
			SYSTEM_CLR_FLAG(System.FaultFlag, FAULT_OVT);
		}
		CmpEn = 0;
	}
}
/*获取系统异常*/
uint16_t system_Get_Fault(uint16_t FaultMask)
{
    return (SYSTEM_GET_FLAG(System.FaultFlag, FaultMask));
}
/*系统异常检测*/


void system_Check_Fault_Task(void)
{
    
    /*过压/欠压保护*/
    system_UDV_OVV_Protect();
    // mc_cur_Sample();
    /*过热保护*/
    // system_OVT_Protect();
}
/********************************函数定义************************************
*函数名:

*函数功能描述: 系统功能-系统交互功能

*函数参数: 无

*函数返回值: 无

*备注:
*****************************************************************************/

/*系统信号输入-推杆限位(1ms定时调用)*/
void system_Read_Column_Limit(void)
{
	static uint8_t s_LimitBtmDbc[MOTOR_NB] = {0};
	static uint8_t s_LimitTopDbc[MOTOR_NB] = {0};
	GPIO_PIN_LEVEL_t ActiveLel = E_GPIO_PIN_RESET;
	/*M1-下限位*/
	if(gpio_adapter_Read_Pin(GPIO_M1_LIMIT_BTM_PORT, GPIO_M1_LIMIT_BTM_PIN) == ActiveLel)
	{
		if(s_LimitBtmDbc[0]++ > 10)
		{
			s_LimitBtmDbc[0] = 10;
			SYSTEM_SET_FLAG(System.LimitFlag, M1_BTM);
		}
	}else
	{
		if(s_LimitBtmDbc[0]-- < 1)
		{
			s_LimitBtmDbc[0] = 0;
			SYSTEM_CLR_FLAG(System.LimitFlag, M1_BTM);
		}
	}
	/*M1-上限位*/
	if(gpio_adapter_Read_Pin(GPIO_M1_LIMIT_TOP_PORT, GPIO_M1_LIMIT_TOP_PIN) == ActiveLel)
	{
		if(s_LimitTopDbc[0]++ > 10)
		{
			s_LimitTopDbc[0] = 10;
			SYSTEM_SET_FLAG(System.LimitFlag, M1_TOP);
		}
	}else
	{
		if(s_LimitTopDbc[0]-- < 1)
		{
			s_LimitTopDbc[0] = 0;
			SYSTEM_CLR_FLAG(System.LimitFlag, M1_TOP);
		}
	}
}
/*系统信号输出-异常状态指示(建议在实时性好的地方调用)*/
void system_Set_Fault_Signal(void)
{
//    if(SYSTEM_GET_FLAG(System.FaultFlag, FAULT_ALL))
//    {
//        if((System.State != E_SYS_STATE_ZERO) || (System.State == E_SYS_STATE_ZERO && System.Step != 3)) //写法待改进
//            gpio_adapter_Set_Pin(FAULT_GPIO_Port, FAULT_Pin);
//    }else
//        gpio_adapter_Reset_Pin(FAULT_GPIO_Port, FAULT_Pin);
}
/*系统信号输出-电机转速(HALL电平状态变化时调用)*/
void system_Set_MotorSpd_Signal(void)
{
//  gpio_adapter_Toggle_Pin(GPIO_MOTOR_SPEED_PORT, GPIO_MOTOR_SPEED_PIN);
}
/*系统信号输入-电机调速*/
void system_Read_MotorSpd_Regulator_Signal(void)
{
//  static float HYS_Voltage = 0.05;    //迟滞电压(单位:V)
//  static int16_t  s_ADData_MSR_Temp = 0;
//  int16_t ADData_MSR = 0;
//  int16_t ADData_HYS = 0;     //变化迟滞
//
//  /*电压采样*/
//  if(1 == adc_adapter_SCM_1Ch_Convert(ADCH_MSPD_ADCH))
//  {
//      ADData_MSR = adc_adapter_Get_Channel_Result(ADCH_MSPD_ADCH);
//      ADData_HYS = (uint16_t)(HYS_Voltage * ADC_FULL_SCALE / ADC_REF_VOLTAGE);
//      if(ADData_MSR >= ADC_FULL_SCALE - 0.1)  //防止电位计模拟输入达不到3.3V,不能输出最大速度
//      {
//          System.MotorSpeed = M_TARGRT_RPM;
//          System.MotorDC = M_MAX_DC;
//      }else
//      {
//          if(abs(ADData_MSR - s_ADData_MSR_Temp) >= ADData_HYS)
//          {
//              //注: 开环/闭环目标最小值在mc_spd, mc_pos有上下限制,即使这里算出来是0,电机实际开环/闭环目标也不是0而是最小目标值!
//              System.MotorSpeed = M_TARGRT_RPM * ADData_MSR / ADC_FULL_SCALE;
//              System.MotorDC = (uint32_t)M_MAX_DC * ADData_MSR / ADC_FULL_SCALE;
//              s_ADData_MSR_Temp = ADData_MSR;
//          }
//      }
//  }
}
/*系统信号输出-电机运行方向,急停信号(1ms调用)*/
void system_Read_MotorControl_Signal(void)
{
//  static uint8_t s_SignalDbc[2] = {0};
//  GPIO_PIN_LEVEL_t ActiveLel_1 = E_GPIO_PIN_RESET;
//
//  /*电机方向信号*/
//  if(gpio_adapter_Read_Pin(GPIO_KEY_DIR_PORT, GPIO_KEY_DIR_PIN) == ActiveLel_1)
//  {
//      if(s_SignalDbc[0]++ > 10)
//      {
//          s_SignalDbc[0] = 10;
//          System.MotorDirSignal = 1;
//      }
//  }else
//  {
//      if(s_SignalDbc[0]-- < 1)
//      {
//          s_SignalDbc[0] = 0;
//          System.MotorDirSignal = 0;
//      }
//  }
}
/*系统信号输入-电机运行模式(1ms定时调用)*/
//SignalMode: 0-电平有效,1-边沿有效
//int8_t system_Read_MC_Mode_Signal(uint8_t SignalMode)
//{
#if 0
    static int8_t s_Debounce = 0;
    static GPIO_PIN_LEVEL_t s_ValidLvl = E_GPIO_PIN_RESET;
    static GPIO_PIN_LEVEL_t s_Lvl = E_GPIO_PIN_RESET;
    GPIO_PIN_LEVEL_t Lvl = E_GPIO_PIN_RESET;

    /*消抖判断*/
    Lvl = gpio_adapter_Read_Pin(GPIO_MC_MODE_SEL_PORT, GPIO_MC_MODE_SEL_PIN);
    if(s_Lvl == Lvl)
        s_Debounce++;
    else
        s_Debounce = 0;
    s_Lvl = Lvl;
    /*电机运行模式选择*/
    if(s_Debounce >= 10)
    {
        s_Debounce = 10;
        if(!SignalMode)
        {
            if(Lvl == E_GPIO_PIN_RESET)
                System.MCMode = 0;
            else
                System.MCMode = 2;
            return 1;
        }else
        {
            if(s_ValidLvl != Lvl)
            {
                s_ValidLvl = Lvl;
                if(Lvl == E_GPIO_PIN_RESET)
                    System.MCMode = 0;
                else
                    System.MCMode = 2;
                return 1;
            }
        }
    }
    return 0;
#else
//    System.MCMode = 1;    //速度闭环模式
//    return 1;
#endif
//}
/*系统信号输出-LED控制接口*/
void system_Led_Ctrl(uint8_t Led, uint8_t Cmd)
{
//  GPIO_PORT_t Port;
//  GPIO_PIN_t Pin;
//  if(Led == LED1)
//  {
//      Port = GPIO_LED1_PORT;
//      Pin = GPIO_LED1_PIN;
//  }else if(Led == LED2)
//  {
//      Port = GPIO_LED2_PORT;
//      Pin = GPIO_LED2_PIN;
//  }else
//      return;
//  /**/
//  if(Cmd == 0)
//      gpio_adapter_Reset_Pin(Port, Pin);
//  else if(Cmd == 1)
//      gpio_adapter_Set_Pin(Port, Pin);
//  else
//      gpio_adapter_Toggle_Pin(Port, Pin);
}


/*更新modbus寄存器*/
void system_Update_MBReg(void)
{
    int32_t Value32 = 0;
    uint8_t Motor_Dir = 0;
    uint8_t Motor_Fault = 0;
    float Motor_PosMM = 0;
    float Motor_Spd_mmps = 0;
    /*根据设备实际状态,更新modbus寄存器表*/
    //MBREG_MOTOR_SLAVE_ADDR       从设备地址(RW)
    modbus_Write_1Reg(g_KVPTable, MBREG_MOTOR_SLAVE_ADDR, hModbusLink.SlaveAddr);
    
    //  MBREG_MOTOR_STATE             //电机状态(R)
    if(MC_RET_OK == mc_app_Read_Param(MOTOR1, e_map_dir, &Value32))
    {
        if(Value32 == 0)
            Motor_Dir = 0x03;
        else if(Value32 == 1)
            Motor_Dir = 0x01;
        else
            Motor_Dir = 0x02;
        modbus_Write_1Reg(g_KVPTable, MBREG_MOTOR_STATE, Motor_Dir);
    }
    if(System.State == E_SYS_STATE_ZERO || System.State == E_SYS_STATE_FAULT)
    {
		Motor_Fault = 0x04;
        if(SYSTEM_GET_FLAG(System.FaultFlag, FAULT_M1_OVC))
            Motor_Fault = 0x05;
        if(SYSTEM_GET_FLAG(System.FaultFlag, FAULT_M1_HAB))
            Motor_Fault = 0x06;
        if(SYSTEM_GET_FLAG(System.FaultFlag, FAULT_UDV))
            Motor_Fault = 0x07;
        if(SYSTEM_GET_FLAG(System.FaultFlag, FAULT_OVV))
            Motor_Fault = 0x08;
		if(SYSTEM_GET_FLAG(System.FaultFlag, FAULT_OVT))
            Motor_Fault = 0x09;
        modbus_Write_1Reg(g_KVPTable, MBREG_MOTOR_STATE, Motor_Fault);
    }
    
    //  MBREG_MOTOR_RPM,    电机当前速度(RW)
    if(MC_RET_OK == mc_app_Read_Param(MOTOR1, e_map_fdbkspd, &Value32))
    {
        Motor_Spd_mmps = system_MotorRPM_2_ColumnSpeed(Value32);
        modbus_Write_1Reg(g_KVPTable, MBREG_MOTOR_RPM, Motor_Spd_mmps);
    }
        
    //  MBREG_MOTOR_FDBKPOS,            //电机位置(R)
    if(MC_RET_OK == mc_app_Read_Param(MOTOR1, e_map_fdbkpos, &Value32))
    {
        Motor_PosMM = system_Column_HallData_2_Pos(Value32);
        modbus_Write_1Reg(g_KVPTable, MBREG_MOTOR_FDBKPOS, Motor_PosMM);
    }
     
    //只写变量
    modbus_Write_1Reg(g_KVPTable, MBREG_MOTOR_CMD, 0);
	modbus_Write_1Reg(g_KVPTable, MBREG_MOTOR_CLR_FAULT, 0);
    modbus_Write_1Reg(g_KVPTable, MBREG_MOTOR_RESET, 0);
    modbus_Write_1Reg(g_KVPTable, MBREG_MOTOR_TARGETSPEED_POS, 0);
    modbus_Write_1Reg(g_KVPTable, MBREG_MOTOR_FDBKPOS_ZERO, 0);
}


/*系统信号处理*/
void system_Signal_LoopTask(void)
{
//    system_Set_Fault_Signal();

//    system_Read_MotorSpd_Regulator_Signal();
}
/********************************函数定义************************************
*函数名:

*函数功能描述: 系统功能-系统掉电数据flash存储

*函数参数: 无

*函数返回值: 无

*备注:
*****************************************************************************/
uint8_t system_Save_Flash(void* System, uint8_t SaveIndex)
{
	SYSTEM_t* pSystem = System;
	syscon_cfg_handle_t hSystemConfig = sys_cfg_Hadnle();
	MOTOR_POS_t WriteIntoFlash[20] = {0};
    int32_t ReadParam[MOTOR_NB] = {0};
	uint8_t Ret = 0;
	/*存推杆位置*/
	if(SaveIndex & FS_MOTOR_SATE)
	{
		if(SYSTEM_GET_FLAG(pSystem->SaveIntoFlash, FS_MOTOR_SATE))
		{
			SYSTEM_CLR_FLAG(pSystem->SaveIntoFlash, FS_MOTOR_SATE);
			flash_adapter_Erase(PAGE, FSA_MOTOR_STATE, 1); 
			mc_app_Read_Param(MOTOR1, e_map_fdbkpos, &ReadParam[0]);
			WriteIntoFlash[0] = 0x55AA;
			WriteIntoFlash[1] = (pSystem->FaultFlag & FAULT_M1_ALL);
			if(pSystem->FaultFlag == 1)
				WriteIntoFlash[2] = ReadParam[0];
			else 
				WriteIntoFlash[2] = 0xFFFF;
			WriteIntoFlash[3] = WriteIntoFlash[0] + WriteIntoFlash[1] + WriteIntoFlash[2];  //求和校验
			flash_adapter_Write(WORD, FSA_MOTOR_STATE, WORD, WriteIntoFlash, 4);
			Ret |= FS_MOTOR_SATE;
		}
	}
	/*存推杆限位*/
	if(SaveIndex & FS_MOTOR_LIMIT)
	{
		if(SYSTEM_GET_FLAG(pSystem->SaveIntoFlash, FS_MOTOR_LIMIT))
		{
			SYSTEM_CLR_FLAG(pSystem->SaveIntoFlash, FS_MOTOR_LIMIT);
			flash_adapter_Erase(PAGE, FSA_MOTOR_LIMIT, 1);
			WriteIntoFlash[0] = 0x5555;
			WriteIntoFlash[1] = system_Get_Column_SpecificPos(COLUMN_POS_SET_TOP);
			WriteIntoFlash[2] = WriteIntoFlash[0] + WriteIntoFlash[1];  //求和校验
			flash_adapter_Write(WORD, FSA_MOTOR_LIMIT, WORD, WriteIntoFlash, 3);
			Ret |= FS_MOTOR_LIMIT;
		}
	}
	/*存系统参数*/
	if(SaveIndex & FS_SYS_PARAM)
	{
		if(SYSTEM_GET_FLAG(pSystem->SaveIntoFlash, FS_SYS_PARAM))
		{
			SYSTEM_CLR_FLAG(pSystem->SaveIntoFlash, FS_SYS_PARAM);
			flash_adapter_Erase(PAGE, FSA_SYS_PARAM, 1);
			WriteIntoFlash[0] = 0xAA55;
			if(pSystem->SysCon.Sys_CommunicationType == E_MODBUS)
			{
				WriteIntoFlash[1] = hModbusLink.SlaveAddr;
				WriteIntoFlash[2] = WriteIntoFlash[0] + WriteIntoFlash[1];
				flash_adapter_Write(WORD, FSA_SYS_PARAM, WORD, WriteIntoFlash, 3);
			}else if(pSystem->SysCon.Sys_CommunicationType == E_CAN)
			{
				WriteIntoFlash[1] = CO_GET_OD(OD_SI_TRG_SPD);
				WriteIntoFlash[2] = CO_GET_OD(OD_SI_HEARTBEAT);
				WriteIntoFlash[3] = CO_GET_OD(OD_SI_NODEID);
				WriteIntoFlash[4] = WriteIntoFlash[0] + WriteIntoFlash[1] + WriteIntoFlash[2] + WriteIntoFlash[3];
				flash_adapter_Write(WORD, FSA_SYS_PARAM, WORD, WriteIntoFlash, 5);
			}
			Ret |= FS_SYS_PARAM;
		}	
	}
	/*存系统配置参数*/
	if(SaveIndex & FS_SYS_CONFIG)
	{
		if(SYSTEM_GET_FLAG(pSystem->SaveIntoFlash, FS_SYS_CONFIG))
		{
			SYSTEM_CLR_FLAG(pSystem->SaveIntoFlash, FS_SYS_CONFIG);
			flash_adapter_Erase(PAGE, FSA_SYS_CONFIG, 1);
			WriteIntoFlash[0] = 0x5A5A;
			WriteIntoFlash[1] = hSystemConfig.Config_GearRatio;
			WriteIntoFlash[2] = hSystemConfig.Config_Lead;
			WriteIntoFlash[3] = hSystemConfig.Config_Route;
			WriteIntoFlash[4] = hSystemConfig.Config_SpeedMmps;
			WriteIntoFlash[5] = hSystemConfig.Config_OvcValue;
			WriteIntoFlash[6] = hSystemConfig.Config_OverVoltage;
			WriteIntoFlash[7] = hSystemConfig.Config_UnderVoltage;
			WriteIntoFlash[8] = WriteIntoFlash[0] + WriteIntoFlash[1] + WriteIntoFlash[2] + WriteIntoFlash[3] + WriteIntoFlash[4] + WriteIntoFlash[5] + WriteIntoFlash[6] + WriteIntoFlash[7]; //求和校验
			flash_adapter_Write(WORD, FSA_SYS_CONFIG, WORD, WriteIntoFlash, 9);
			Ret |= FS_SYS_CONFIG;
		}
	}
	/*存电机配置参数*/
	if(SaveIndex & FS_MOTOR_CONFIG)
	{
		if(SYSTEM_GET_FLAG(pSystem->SaveIntoFlash, FS_MOTOR_CONFIG))
		{
			SYSTEM_CLR_FLAG(pSystem->SaveIntoFlash, FS_MOTOR_CONFIG);
			flash_adapter_Erase(PAGE, FSA_MOTOR_CONFIG, 1);
			WriteIntoFlash[0] = 0x5AA5;
			WriteIntoFlash[1] = hSystemConfig.Config_NodeSlaveAddr;
			WriteIntoFlash[2] = hSystemConfig.Config_CommunicationType;
			WriteIntoFlash[3] = hSystemConfig.Config_ResetRunMode;
			WriteIntoFlash[4] = hSystemConfig.Config_ResetDirection;
			WriteIntoFlash[5] = hSystemConfig.Config_ResetMode;
			WriteIntoFlash[6] = hSystemConfig.Config_ResetRaise;
			WriteIntoFlash[7] = hSystemConfig.Config_MotorRunMode;
			WriteIntoFlash[8] = hSystemConfig.Config_TopDetection;
			WriteIntoFlash[9] = hSystemConfig.Config_BtmDetection;
			WriteIntoFlash[10] = WriteIntoFlash[0] + WriteIntoFlash[1] + WriteIntoFlash[2] + WriteIntoFlash[3] + WriteIntoFlash[4] + WriteIntoFlash[5] + WriteIntoFlash[6] + WriteIntoFlash[7] + WriteIntoFlash[8] + WriteIntoFlash[9]; //求和校验
			flash_adapter_Write(WORD, FSA_MOTOR_CONFIG, WORD, WriteIntoFlash, 11);
			Ret |= FS_MOTOR_CONFIG;
		}
	}
	/*存底层配置参数*/
	if(SaveIndex & FS_BOOT_CONFIG)
	{
		if(SYSTEM_GET_FLAG(pSystem->SaveIntoFlash, FS_BOOT_CONFIG))
		{
			SYSTEM_CLR_FLAG(pSystem->SaveIntoFlash, FS_BOOT_CONFIG);
			flash_adapter_Erase(PAGE, FSA_BOOT_CONFIG, 1);
			WriteIntoFlash[0] = 0xAA55;
			WriteIntoFlash[1] = hSystemConfig.Config_HallDirectionSel;
			WriteIntoFlash[2] = hSystemConfig.Config_PhaseDirectionSel;
			WriteIntoFlash[3] = WriteIntoFlash[0] + WriteIntoFlash[1] + WriteIntoFlash[2]; //求和校验
			flash_adapter_Write(WORD, FSA_BOOT_CONFIG, WORD, WriteIntoFlash, 4);
			Ret |= FS_BOOT_CONFIG;
		}
	}
	return Ret;
}
/********************************函数定义************************************
*函数名:

*函数功能描述: 系统功能-系统状态机任务

*函数参数: 无

*函数返回值: 无

*备注:
*****************************************************************************/
/*状态任务-初始化状态(建议应用层调用此函数后加个return,防止周期内2次修改状态的情况发生)*/
void system_FSM_StateJump(SYSTEM_t* pSystem, SYS_STATE_t NextState)
{
    SYS_STATE_t State = pSystem->State;
    
    if(NextState == E_SYS_STATE_INIT)
    {

    }else if(NextState == E_SYS_STATE_ZERO)
    {
        if(State == E_SYS_STATE_INIT || State == E_SYS_STATE_FAULT || State == E_SYS_STATE_IDLE)
            goto JUMP;
    }else if(NextState == E_SYS_STATE_IDLE)
    {
        if(State == E_SYS_STATE_INIT || State == E_SYS_STATE_ZERO || State == E_SYS_STATE_MOTOR_RUN \
			|| State == E_SYS_STATE_FAULT || State == E_SYS_STATE_MOTOR_GOTOPOS || State == E_SYS_STATE_SETTINGS\
            || State == E_SYS_STATE_SETZEROPOS || State == E_SYS_CONFIG_INIT)
            goto JUMP;
    }else if(NextState == E_SYS_STATE_MOTOR_RUN)
    {
        if(State == E_SYS_STATE_IDLE)
            goto JUMP;
    }else if(NextState == E_SYS_STATE_FAULT)
    {
        if(State == E_SYS_STATE_INIT || State == E_SYS_STATE_MOTOR_RUN || State == E_SYS_STATE_ZERO \
			|| State == E_SYS_STATE_IDLE || State == E_SYS_STATE_MOTOR_GOTOPOS || State == E_SYS_STATE_SETZEROPOS)
            goto JUMP;
    }else if(NextState == E_SYS_STATE_SETTINGS)
    {
        if(State == E_SYS_STATE_IDLE)
            goto JUMP;
    }else if(NextState == E_SYS_STATE_MOTOR_GOTOPOS)
    {
        if(State == E_SYS_STATE_IDLE)
            goto JUMP;
    }else if(NextState == E_SYS_STATE_SETZEROPOS)
    {
         if(State == E_SYS_STATE_IDLE)
            goto JUMP;
	}else if(NextState == E_SYS_CONFIG_INIT)
    {
         if(State == E_SYS_STATE_IDLE || State == E_SYS_STATE_FAULT)
            goto JUMP;
    }else
    {   //do nothing
    }
    return;
JUMP:
    pSystem->State = NextState;
    pSystem->Step = 0;
}
/*系统配置的初始化*/
void system_ConfigInit_Handler(void* System)
{
	SYSTEM_t* pSystem = System;
	sys_cfg_flag_handle_t* hSystemFlagCfg = sys_cfg_FlagHandle();
//	SysCfg->ControlMode = E_CONFIGMODE;
	hSystemFlagCfg->PerameterSetMode = E_CONFIGMODESET;
	SYSTEM_SET_FLAG(hSystemFlagCfg->ControlMode,SYS_CFG_CONTROL_MODE);
	if(pSystem->Step == 0)
	{
		pSystem->CfgCount = 0;
		pSystem->Step++;
	}
	else if(pSystem->Step == 1)
	{
		if(SYSTEM_GET_FLAG(hSystemFlagCfg->SaveCfgFlashFlag,SYS_CFG_SAVE_FLASH_FLAG))
		{
			SYSTEM_CLR_FLAG(hSystemFlagCfg->SaveCfgFlashFlag,SYS_CFG_SAVE_FLASH_FLAG);
			SYSTEM_SET_FLAG(pSystem->SaveIntoFlash, FS_SYS_CONFIG);
			SYSTEM_SET_FLAG(pSystem->SaveIntoFlash, FS_MOTOR_CONFIG);
			SYSTEM_SET_FLAG(pSystem->SaveIntoFlash, FS_BOOT_CONFIG);
			/*存储flash数据*/
			(void)system_Save_Flash(pSystem, (FS_SYS_CONFIG | FS_MOTOR_CONFIG | FS_BOOT_CONFIG));
			sys_cfg_Controller();/*退出配置模式提示*/
			hSystemFlagCfg->PerameterSetMode = E_IDLEMODESET;
			/*配置完成以后需要把关于电机配置相关的Flash全擦除*/
			flash_adapter_Erase(PAGE, FSA_MOTOR_STATE, 1);
			flash_adapter_Erase(PAGE, FSA_MOTOR_LIMIT, 1);
			flash_adapter_Erase(PAGE, FSA_SYS_PARAM, 1);
/*************************************************************系统复位代码*******************************************************************************/
			__DSB();                                                          /* Ensure all outstanding memory accesses included
																		   buffered write are completed before reset */
			SCB->AIRCR  = (uint32_t)((0x5FAUL << SCB_AIRCR_VECTKEY_Pos)    |
								   (SCB->AIRCR & SCB_AIRCR_PRIGROUP_Msk) |
									SCB_AIRCR_SYSRESETREQ_Msk    );         /* Keep priority group unchanged */
			__DSB();                                                          /* Ensure completion of memory access */

			for(;;)                                                           /* wait until reset */
			{
				__NOP();
			}
/************************************************************************************************************************************************/
		}
		
		if(pSystem->CfgCount >= 3000)
		{
			sys_cfg_Controller();/*退出配置模式提示*/
			pSystem->Step++;
		}
	}
	else if(pSystem->Step == 2)
	{
		system_FSM_StateJump(pSystem, E_SYS_STATE_IDLE);
	}
}

/*状态任务-初始化状态*/
void system_Init_Handler(void* System)
{
    SYSTEM_t* pSystem = System;
	uint32_t Data[10] = {0};
    uint32_t Check = 0;
    system_Communication_None();
	/*推杆配置参数初始化*/
	system_Motor_Init(pSystem);
//    /*初始化电机控制模式*/
//    while(system_Read_MC_Mode_Signal(0) == 0);
	/*初始化电机控制参数*/
	pSystem->MotorDC = M_MAX_DC;
	pSystem->MotorSpeed = system_Modify_Column_Speed(0, pSystem->SysCon.Sys_SpeedMmps);
    
    /*初始化上限位*/
    //system_Set_Column_SpecificPos(COLUMN_POS_ZERO, RESET_RAISE);
	if(pSystem->SysCon.Sys_ResetDirection == E_RESET_BTM)
	{
		system_Set_Column_SpecificPos(COLUMN_POS_ZERO, (BTM_POS_HALLDATA + pSystem->SysCon.Sys_ResetRaise));
		system_Set_Column_SpecificPos(COLUMN_POS_TOP_LIMIT, pSystem->SysCon.Sys_Route);
		system_Set_Column_SpecificPos(COLUMN_POS_SET_TOP, pSystem->SysCon.Sys_Route);
	}else if(pSystem->SysCon.Sys_ResetDirection == E_RESET_TOP)
	{
		system_Set_Column_SpecificPos(COLUMN_POS_ZERO, BTM_POS_HALLDATA);
		system_Set_Column_SpecificPos(COLUMN_POS_TOP_LIMIT, (pSystem->SysCon.Sys_Route + pSystem->SysCon.Sys_ResetRaise));
		system_Set_Column_SpecificPos(COLUMN_POS_SET_TOP, (pSystem->SysCon.Sys_Route + pSystem->SysCon.Sys_ResetRaise));
	}
    flash_adapter_Read(DOUBLE_WORD, FSA_MOTOR_LIMIT, WORD, Data, sizeof Data / sizeof Data[0]);
    if(Data[0] == 0x5555)
    {
        Check = Data[0] + Data[1];
        if(Check == Data[2])
        {
            system_Set_Column_SpecificPos(COLUMN_POS_SET_TOP, (float)Data[1]);
        }
    }
	system_Communication_Motor_Init(); //系统配置初始化
	
	/*初始化推杆位置*/
    flash_adapter_Read(WORD, FSA_MOTOR_STATE, WORD, Data, 4);
    if(Data[0] != 0x55AA)
    {
		system_Reset_Noreset(pSystem); //电机是否需要复位
    }else
    {
        Check = Data[0] + Data[1] + Data[2];
        if(Check != Data[3])
        {
			system_Reset_Noreset(pSystem); //电机是否需要复位
        }else
        {
			SYSTEM_SET_FLAG(pSystem->FaultFlag, Data[1]);
			if(Data[2] == 0xFFFF)
			{
				 pSystem->ZeroFound = 0;
			}else
			{
				mc_app_Write_Param((MOTOR1), e_map_fdbkpos, Data[2]);
				pSystem->ColumnPosMM[0] = system_Get_Column_CurrentPos(0);
				pSystem->ZeroFound = 1;
			}
			flash_adapter_Erase(PAGE, FSA_MOTOR_STATE, 1);
			SYSTEM_SET_FLAG(pSystem->SaveIntoFlash, FS_MOTOR_SATE);	/* 正常状态下也需要设置故障和行程保存标志，保证多次掉电以后上电还保存之前的故障代码 */
            system_FSM_StateJump(pSystem, E_SYS_STATE_IDLE);
        }
    }

}
/*状态任务-找零状态*/
void system_FindZero_Handler(void* System)
{
    SYSTEM_t* pSystem = System;
    BTN_STATE_t KeyMResetState = syste_Reset_Mode();

    //参数初始化
    if(pSystem->Step == 0)
    {
        flash_adapter_Erase(PAGE, FSA_MOTOR_STATE, 1);
        for(uint8_t i = 0; i< SYS_MOTOR_NB; i++)
        {
            mc_app_Write_Param((MOTOR1<<i), e_map_drvoutput_max, PWM_OUTPUT_FULLSCALE / 2);
            system_Modify_Column_Speed(i, pSystem->SysCon.Sys_SpeedMmps / 2);  //复位减半速
        }
        pSystem->Step = 2;
    }
    /*复位暂停后,重启复位的条件判断*/
    else if(pSystem->Step == 1)
    {
		for(uint8_t i = 0; i< SYS_MOTOR_NB; i++)
        {
            mc_app_Write_Param((MOTOR1<<i), e_map_drvoutput_max, PWM_OUTPUT_FULLSCALE / 2);
            system_Modify_Column_Speed(i, pSystem->SysCon.Sys_SpeedMmps / 2);  //复位减半速
        }
		if(system_Reset_Direction(pSystem) == 1)
		{
			pSystem->Step++;
		}
    }
    /*电机启动复位找零*/
    else if(pSystem->Step == 2)
    {
        if(system_Reset_Start() == 1)
        {
            pSystem->Step++;
        }
    }
    /*运行到0位判断及电机异常检测(2种检测并存: 限位开关 || 堵转)*/
    else if(pSystem->Step == 3)
    {
		if(system_Reset_Detection_Mode(pSystem) == 1)
		{
			pSystem->Step++;
		}
    }
    /*复位后初始位置*/
    else if(pSystem->Step == 4)
    {
		if(system_Reset_Initial_Position() == 1)
		{
			pSystem->Step++;
		}
    }
    /*复位运行到初始位置完成*/
    else if(pSystem->Step == 5)
    {
        if(mc_app_Get_State(MOTOR1) == e_mas_idle)
        {
            if(!SYSTEM_GET_FLAG(pSystem->FaultFlag, FAULT_M1_ALL))  //无电机故障即可
            {
                pSystem->Step++;
            }
        }
    }
    /*复位成功,退出复位*/
    else if(pSystem->Step == 6)
    {
        pSystem->ZeroFound = 1;
		system_Communication_None();
        SYSTEM_CLR_FLAG(pSystem->FaultFlag, FAULT_POS);
        SYSTEM_SET_FLAG(pSystem->SaveIntoFlash, FS_MOTOR_SATE);
        if(KeyMResetState == E_BTN_STA_RELEASED)
        {
            for(uint8_t i = 0; i< SYS_MOTOR_NB; i++)
            {
                mc_app_Write_Param((MOTOR1<<i), e_map_drvoutput_max, (PWM_OUTPUT_FULLSCALE / 100) * MAX_PWM_PERCENT);
                system_Modify_Column_Speed(i, pSystem->SysCon.Sys_SpeedMmps);  //速度恢复正常速度
            }
            system_FSM_StateJump(pSystem, E_SYS_STATE_IDLE);
            return;
        }
    }
    /*正常停止*/
    else if(pSystem->Step == 100)
    {
        if(system_Is_Motor_Stop(MOTOR1))
        {
            pSystem->Step = 1;       /*之前modbus通讯是直接给Step=1*/
            if(pSystem->ZeroFound == 1)
            {
                SYSTEM_CLR_FLAG(pSystem->FaultFlag, FAULT_POS);
                SYSTEM_SET_FLAG(pSystem->SaveIntoFlash, FS_MOTOR_SATE);
            }
            for(uint8_t i = 0; i< SYS_MOTOR_NB; i++)
            {
                mc_app_Write_Param((MOTOR1<<i), e_map_drvoutput_max, (PWM_OUTPUT_FULLSCALE / 100) * MAX_PWM_PERCENT);
                system_Modify_Column_Speed(i, pSystem->SysCon.Sys_SpeedMmps);  //速度恢复正常速度
            }
        }else
        {
            system_Motor_Ramp_Stop(MOTOR1, e_mac_stop_openloop);   //ps: 复位暂停,若执行慢停止有概率会运行到底堵转,产生报错
        }
    }else
    {
        //do nothing
    }
    /*电机运行异常检测(运行时不检测过热)*/
    if(system_Get_Fault(FAULT_UDV | FAULT_OVV))
    {
    
        if(pSystem->ZeroFound == 1)
            SYSTEM_SET_FLAG(pSystem->SaveIntoFlash, FS_MOTOR_SATE);
        system_FSM_StateJump(pSystem, E_SYS_STATE_FAULT);
    }else if(system_Get_Fault(FAULT_MOTOR_ALL))
    {
        if(pSystem->Step != 3 && pSystem->Step != 100)
		{
			SYSTEM_SET_FLAG(pSystem->SaveIntoFlash, FS_MOTOR_SATE);
            system_FSM_StateJump(pSystem, E_SYS_STATE_FAULT);
		}
    }else
    {
		if(system_Reset_Run_Mode(KeyMResetState) == 1)
		{
			if(pSystem->Step > 2 && pSystem->Step < 100)
                pSystem->Step = 100;
		}
		/*有按键操作-缓停*/
		if(KeyMResetState != E_BTN_STA_RELEASED)
		{
			pSystem->ResetHandControlling = 1;	//变为手控模式(不打断同向的运行)
		}
    }
}
/*状态任务-空闲状态*/
void system_Idle_Handler(void* System)
{
    SYSTEM_t* pSystem = System;
	sys_cfg_flag_handle_t* hSystemFlagCfg = sys_cfg_FlagHandle();
    float ColumnPos = 0;
    BTN_STATE_t KeyMUState = btn_Get_State(KEY_MOTOR_UP);
    BTN_STATE_t KeyMDState = btn_Get_State(KEY_MOTOR_DOWN);
	pSystem->RunDir = DIR_STOP;
	
	/*上位机触发配置功能 程序从空闲状态跳入配置初始化状态*/
	if(SYSTEM_GET_FLAG(hSystemFlagCfg->EnterConfigFlag,SYS_CFG_ENTER_CFG_FLAG))
	{
		SYSTEM_CLR_FLAG(hSystemFlagCfg->EnterConfigFlag,SYS_CFG_ENTER_CFG_FLAG);
		system_FSM_StateJump(pSystem, E_SYS_CONFIG_INIT);
		return;
	}
    
	/*异常检测及LED显示*/
	if(system_Get_Fault(FAULT_NOT_MOTOR_ALL))
	{
		system_FSM_StateJump(pSystem, E_SYS_STATE_FAULT);
	}
    /*存储flash数据*/
//	(void)system_Save_Flash(pSystem, (FS_MOTOR_SATE | FS_MOTOR_LIMIT | FS_SYS_PARAM ));
    
	if(pSystem->ZeroFound == 1)
	{
		system_Idle_ComGotoPos(pSystem);
	}
	/*进入电机运行状态(注: IO控制优先级高于上位机通讯控制)*/
	if(KeyMUState == E_BTN_STA_RELEASED && KeyMDState == E_BTN_STA_RELEASED)
    {
		pSystem->HandControlling = 0;
		system_Idle_ComRun(pSystem);
    }else
    {
		if(pSystem->SysCon.Sys_MotorRunMode == E_MOTOR_INCHING)
		{
			pSystem->HandControlling = 1;
		}else
		{
		}
		system_Communication_None();		//手控模式下不响应通讯命令
		if(KeyMUState != E_BTN_STA_RELEASED && KeyMDState != E_BTN_STA_RELEASED)
		{
			return;		//组合键按下是急停功能,电机不动作
		}else
		{
            if(KeyMUState == E_BTN_STA_FIRSTPRESSHOLD || KeyMUState == E_BTN_STA_LONGPRESS)
            {
                ColumnPos = system_Get_Column_SpecificPos(COLUMN_POS_SET_TOP);
				pSystem->RunDir = DIR_UP;
				if(system_Idle_Start(pSystem,ColumnPos) == 1)
					return;
            }
            if(KeyMDState == E_BTN_STA_FIRSTPRESSHOLD || KeyMDState == E_BTN_STA_LONGPRESS)
            {
                ColumnPos = system_Get_Column_SpecificPos(COLUMN_POS_ZERO);
                pSystem->RunDir = DIR_DOWN;
                if(system_Idle_Start(pSystem,ColumnPos) == 1)
					return;
            }
			
		}
    }
    
}
/*状态任务-电机运行状态*/
void system_MotorRun_Handler(void* System)
{
    SYSTEM_t* pSystem = System;
    BTN_STATE_t KeyMUState = btn_Get_State(KEY_MOTOR_UP);
    BTN_STATE_t KeyMDState = btn_Get_State(KEY_MOTOR_DOWN);

    /*电机启动初始化*/
    if(pSystem->Step == 0)
    {
		if(SYSTEM_GET_FLAG(pSystem->LimitFlag, M1_TOP) && pSystem->RunDir == DIR_UP)
		{
            system_FSM_StateJump(pSystem, E_SYS_STATE_IDLE);
            return;
		}else if(SYSTEM_GET_FLAG(pSystem->LimitFlag, M1_BTM) && pSystem->RunDir == DIR_DOWN)
		{
			mc_app_Write_Param(MOTOR1, e_map_fdbkpos, BTM_POS_HALLDATA);//只在电机运行时清零位置,防止开关误触发(客户反馈断24V/5V时会有此现象)
            pSystem->ZeroFound = 1;
            system_FSM_StateJump(pSystem, E_SYS_STATE_IDLE);
            return;
		}else
		{
			pSystem->Step++;
            /*电机启动*/
			flash_adapter_Erase(PAGE, FSA_MOTOR_STATE, 1);    //启动时擦除已存储的位置
			system_Motor_Move(MOTOR1, e_mac_start_closeloop, pSystem->RunDir);
		}
		btn_Clr_Event(KEY_MOTOR_UP);
		btn_Clr_Event(KEY_MOTOR_DOWN);
    }
	/*电机运行*/
    else if(pSystem->Step == 1)
    {
        /*电机运行实时速度调节*/
        mc_app_Write_Param(MOTOR1, e_map_targetspd, pSystem->MotorSpeed);
    }
    /*执行慢停止动作*/
    else if(pSystem->Step == 100)
    {
        system_Motor_Ramp_Stop(MOTOR1, e_mac_stop_closeloop);
        pSystem->Step++;
    }
    /*执行急停动作*/
    else if(pSystem->Step == 200)
    {
        mc_app_Set_Single_Motor_Cmd(MOTOR1, e_mac_stop, 0);
        pSystem->Step++;
    }
    /*判断电机非故障停止*/
    else
    {
        if(system_Is_Motor_Stop(MOTOR1))
        {
			system_SignalSwitch();
			if(pSystem->ZeroFound == 1)
				SYSTEM_SET_FLAG(pSystem->SaveIntoFlash, FS_MOTOR_SATE);
            system_FSM_StateJump(pSystem, E_SYS_STATE_IDLE);
            return;
        }
    }

    /*电机运行时异常(运行时不检测过热)-急停*/
    if(system_Get_Fault(FAULT_M1_HAB))
    {
		if(system_CfgBtmDetet() == E_BTM_HALL_ABNORMAL)
		{
			if(pSystem->RunDir == DIR_DOWN)
			{
				system_Clear_Motor_Fault(MOTOR1);
				mc_app_Write_Param(MOTOR1, e_map_fdbkpos, BTM_POS_HALLDATA);//只在电机运行时清零位置,防止开关误触发(客户反馈断24V/5V时会有此现象)
				pSystem->ZeroFound = 1;
				if(pSystem->Step < 200)
				{
					pSystem->Step = 200;
				}
			}else if(system_CfgTopDetet() != E_TOP_HALL_ABNORMAL)
			{
				SYSTEM_SET_FLAG(pSystem->SaveIntoFlash, FS_MOTOR_SATE);
				system_FSM_StateJump(pSystem, E_SYS_STATE_FAULT);
				return;
			}				
		}
		if(system_CfgTopDetet() == E_TOP_HALL_ABNORMAL)
		{
			
			if(pSystem->RunDir == DIR_UP)
			{
				system_Clear_Motor_Fault(MOTOR1);
				mc_app_Write_Param(MOTOR1, e_map_fdbkpos, (MOTOR_POS_t)((system_Hall_PER_MM())*pSystem->SysCon.Sys_Route));//只在电机运行时清零位置,防止开关误触发(客户反馈断24V/5V时会有此现象)
				pSystem->ZeroFound = 1;
				if(pSystem->Step < 200)
				{
					pSystem->Step = 200;	
				}
			}else if(system_CfgBtmDetet() != E_BTM_HALL_ABNORMAL)
			{
				SYSTEM_SET_FLAG(pSystem->SaveIntoFlash, FS_MOTOR_SATE);
				system_FSM_StateJump(pSystem, E_SYS_STATE_FAULT);
				return;
			}
		}
		if((system_CfgBtmDetet() != E_BTM_HALL_ABNORMAL) &&(system_CfgTopDetet() != E_TOP_HALL_ABNORMAL))
		{
			SYSTEM_SET_FLAG(pSystem->SaveIntoFlash, FS_MOTOR_SATE);
			system_FSM_StateJump(pSystem, E_SYS_STATE_FAULT);
			return;
		}
    }
    /*电机运行时异常(运行时不检测过热)-急停*/
    else if(system_Get_Fault(FAULT_OVV | FAULT_UDV | FAULT_M1_OVC))
    {
        SYSTEM_SET_FLAG(pSystem->SaveIntoFlash, FS_MOTOR_SATE);
        system_FSM_StateJump(pSystem, E_SYS_STATE_FAULT);
    }
    /*到硬限位-急停*/
    else if((pSystem->RunDir == DIR_UP && (pSystem->LimitFlag & M1_TOP)) || \
			(pSystem->RunDir == DIR_DOWN && (pSystem->LimitFlag & M1_BTM)) )
    {
        if(pSystem->Step < 200)
            pSystem->Step = 200;
    }
    /*上下组合键按下-急停*/
	else if(KeyMUState != E_BTN_STA_RELEASED && KeyMDState != E_BTN_STA_RELEASED)
	{
		pSystem->HandControlling = 1;
        if(pSystem->Step < 200)
            pSystem->Step = 200;	
	}
    /*转入慢停止条件*/
    else
    {
		/*电机运行模式  点动or续动*/
		if(system_Motor_Run_Mode(KeyMUState,KeyMDState) == 1)
		{
			if(pSystem->Step < 100)
				pSystem->Step = 100;
		}
		/*有按键操作-缓停*/
		if(KeyMUState != E_BTN_STA_RELEASED || KeyMDState != E_BTN_STA_RELEASED)
		{
			pSystem->HandControlling = 1;	//变为手控模式(不打断同向的运行)
		}
    }
    /*手控模式下不响应上位机命令*/
	if(pSystem->HandControlling == 1)
	{
		system_Communication_None();  //上位机空闲指令
	}else
	{
		/*通讯命令变化-运行到目标位置*/
		if(system_Communication_Goto() == 1)
		{
			//pSystem->ModbusCmd = e_cmc_none;		不清除ModbusCanCmd命令(挂起),让系统跳到IDLE状态后可响应此命令
			if(pSystem->Step < 100)
				pSystem->Step = 100;
		}
		/*通讯命令变化-停止*/
		if(system_Communication_Stop() == 1)
		{
			system_Communication_None();
			if(pSystem->Step < 100)
				pSystem->Step = 100;
		}		
		/*通讯命令变化-上升/下降*/
		else if(((system_Communication_Down() ==1) && pSystem->RunDir == DIR_UP) || \
				((system_Communication_Up() == 1) && pSystem->RunDir == DIR_DOWN))
		{
			//pSystem->ModbusCmd = e_cmc_none;		不清除ModbusCanCmd命令(挂起),让系统跳到IDLE状态后可响应此命令
			if(pSystem->Step < 100)
				pSystem->Step = 100;
		}
	}

}
/*状态任务-电机自动运行到目标位置状态*/
void system_MotorGotoPos_Handler(void* System)
{
    SYSTEM_t* pSystem = System;
    int32_t ReadParam[MOTOR_NB] = {0};
    static MOTOR_POS_t s_TargetHallPos = 0;
    MOTOR_POS_t ColumnHallPos = 0;
	int8_t SysSign = 0;	
    float ColumnPosTop = 0;
    float ColumnPosBtm = 0;
    MOTOR_SPD_t MotorSpd = 0;
    static float s_SlowStopMM = 0;
    BTN_STATE_t KeyMUState = btn_Get_State(KEY_MOTOR_UP);
    BTN_STATE_t KeyMDState = btn_Get_State(KEY_MOTOR_DOWN);

    //更新推杆当前位置
    ColumnPosTop = system_Get_Column_SpecificPos(COLUMN_POS_SET_TOP);
    ColumnPosBtm = system_Get_Column_SpecificPos(COLUMN_POS_ZERO);


    /*电机首次启动初始化*/
    if(pSystem->Step == 0)
    {
        mc_app_Read_Param(MOTOR1, e_map_fdbkpos, &ReadParam[0]);
        if(pSystem->GotoHallPos + 10 < ReadParam[0])
        {
            pSystem->RunDir = DIR_DOWN;
			flash_adapter_Erase(PAGE, FSA_MOTOR_STATE, 1);    //启动时擦除已存储的位置
            mc_app_Set_Single_Motor_Cmd(MOTOR1, e_mac_goto_targetpos, pSystem->GotoHallPos);
            pSystem->Step = 2;
        }else if(pSystem->GotoHallPos > ReadParam[0] + 10)
        {
            pSystem->RunDir = DIR_UP;		
			flash_adapter_Erase(PAGE, FSA_MOTOR_STATE, 1);    //启动时擦除已存储的位置
            mc_app_Set_Single_Motor_Cmd(MOTOR1, e_mac_goto_targetpos, pSystem->GotoHallPos);
            pSystem->Step = 2;
        }else
        {
            system_FSM_StateJump(pSystem, E_SYS_STATE_IDLE);
            return;
        }
		btn_Clr_Event(KEY_MOTOR_UP);
		btn_Clr_Event(KEY_MOTOR_DOWN);
    }else if(pSystem->Step == 1)
    {
		/*目标位置更新的重启*/   
        mc_app_Read_Param(MOTOR1, e_map_fdbkpos, &ReadParam[0]);
        if(pSystem->GotoHallPos + 10 < ReadParam[0])
        {
            pSystem->RunDir = DIR_DOWN;
            mc_app_Set_Single_Motor_Cmd(MOTOR1, e_mac_goto_targetpos, pSystem->GotoHallPos);
        }else if(pSystem->GotoHallPos > ReadParam[0] + 10)
        {
            pSystem->RunDir = DIR_UP;
            mc_app_Set_Single_Motor_Cmd(MOTOR1, e_mac_goto_targetpos, pSystem->GotoHallPos);
        }
		pSystem->Step++;
    }
    /*电机运行*/
    else if(pSystem->Step == 2)
    {
        /*电机运行实时速度调节*/
        mc_app_Write_Param(MOTOR1, e_map_ol_targetdc, pSystem->MotorDC);
		mc_app_Write_Param(MOTOR1, e_map_targetspd, pSystem->MotorSpeed); //modbus的程序中在运行到目标位置的程序中是没有实时更新速度的，后续需要测试
        /*计算慢停止距离(值选取和速度,加速度都有关系,目前只考虑停止速度)*/
        mc_app_Read_Param(MOTOR1, e_map_fdbkspd, &MotorSpd);
		SysSign = (MotorSpd >= 0)? 1 : (-1) ;
		s_SlowStopMM = (MotorSpd + (SysSign*250)) / 500 + (SysSign*MOTOR_SLOW_STOP) ;  //计算公式CAN和modbus的不一样需要后续确认
//        s_SlowStopMM = (MotorSpd + 250) / 500 + 0.1;	 //转速<3000,选这个停止距离
        /*运行到目标位置判断*/
        if(mc_app_Get_State(MOTOR1) == e_mas_idle)
        {
            SYSTEM_SET_FLAG(pSystem->SaveIntoFlash, FS_MOTOR_SATE);
            system_FSM_StateJump(pSystem, E_SYS_STATE_IDLE);
            return;
        }
    }
    /*执行慢停止动作*/
    else if(pSystem->Step == 100)
    {
        mc_app_Read_Param(MOTOR1, e_map_fdbkpos, &ReadParam[0]);
        s_TargetHallPos = ReadParam[0] + (MOTOR_POS_t)(s_SlowStopMM * (system_Hall_PER_MM()));   //缓停止
        if(pSystem->RunDir == DIR_UP)
        {
            ColumnHallPos = system_Column_Pos_2_HallData(ColumnPosTop);
            if(s_TargetHallPos > ColumnHallPos)
                s_TargetHallPos = ColumnHallPos;
        }else //RunDir == DIR_DOWN
        {
            ColumnHallPos = system_Column_Pos_2_HallData(ColumnPosBtm);
            if(s_TargetHallPos < ColumnHallPos)
                s_TargetHallPos = ColumnHallPos;
        }
        mc_app_Set_Single_Motor_Cmd(MOTOR1, e_mac_goto_targetpos, s_TargetHallPos);
        pSystem->Step++;
    }
    /*执行急停动作*/
    else if(pSystem->Step == 200)
    {
        mc_app_Set_Single_Motor_Cmd(MOTOR1, e_mac_stop, 0);
        pSystem->Step++;
    }
    /*判断电机非故障停止*/
    else
    {
        if(system_Is_Motor_Stop(MOTOR1))
        {
            SYSTEM_SET_FLAG(pSystem->SaveIntoFlash, FS_MOTOR_SATE);
            system_FSM_StateJump(pSystem, E_SYS_STATE_IDLE);
            return;
        }
    }
    /*电机运行时异常(运行时不检测过热)-急停*/
    if(system_Get_Fault(FAULT_MOTOR_ALL))
    {
		SYSTEM_SET_FLAG(pSystem->SaveIntoFlash, FS_MOTOR_SATE);
        system_FSM_StateJump(pSystem, E_SYS_STATE_FAULT);
		return;
    }
    /*电机运行时异常(运行时不检测过热)-急停*/
    else if(system_Get_Fault(FAULT_OVV | FAULT_UDV))
    {
        SYSTEM_SET_FLAG(pSystem->SaveIntoFlash, FS_MOTOR_SATE);
        system_FSM_StateJump(pSystem, E_SYS_STATE_FAULT);
		return;
    }
	/*到硬限位-急停*/
    else if((pSystem->RunDir == DIR_UP && (pSystem->LimitFlag & M1_TOP)) || \
			(pSystem->RunDir == DIR_DOWN && (pSystem->LimitFlag & M1_BTM)) )
    {
        if(pSystem->Step < 200)
            pSystem->Step = 200;
    }
	/*上下组合键按下-急停*/
	else if(KeyMUState != E_BTN_STA_RELEASED && KeyMDState != E_BTN_STA_RELEASED)
	{
		pSystem->HandControlling = 1;
        if(pSystem->Step < 200)
            pSystem->Step = 200;
	}
    /*退出自动运行,转入慢停止*/
    else
    {
		/*电机运行模式  点动or续动*/
		if(system_Motor_Run_Mode(KeyMUState,KeyMDState) == 1)
		{
			if(pSystem->Step < 100)
				pSystem->Step = 100;
		}
		/*有按键操作-缓停*/
		if(KeyMUState != E_BTN_STA_RELEASED || KeyMDState != E_BTN_STA_RELEASED)
		{
			pSystem->HandControlling = 1;	//变为手控模式(不打断同向的运行)
		}	
    }
    /*手控操作下不响应通讯命令*/
	if(pSystem->HandControlling == 1)
	{
		system_Communication_None(); //上位机空闲指令		
	}else
	{
		/*通讯命令变化-目标位置更新*/
		if(system_Communication_Goto() == 1)
		{
			system_Communication_None(); //上位机空闲指令
			if(pSystem->Step < 100 && pSystem->Step > 0)
			{
				pSystem->Step = 1;
				pSystem->GotoHallPos = system_Communication_Updategotopos();
			}
		}
		/*通讯命令变化-停止*/
		else if(system_Communication_Stop() == 1)
		{
			system_Communication_None(); //上位机空闲指令
			if(pSystem->Step < 100)
				pSystem->Step = 100;
		}
		/*通讯命令变化-上升/下降*/
		else if(((system_Communication_Down() ==1) && pSystem->RunDir == DIR_UP) || \
				((system_Communication_Up() == 1) && pSystem->RunDir == DIR_DOWN))
		{
			//pSystem->ModbusCmd = e_cmc_none;		不清除ModbusCanCmd命令(挂起),让系统跳到IDLE状态后可响应此命令
			if(pSystem->Step < 100)
				pSystem->Step = 100;
		}
	}
}
/*状态任务-电机故障状态*/
void system_Fault_Handler(void* System)
{
    SYSTEM_t* pSystem = System;
	sys_cfg_flag_handle_t* hSystemFlagCfg = sys_cfg_FlagHandle();
	BTN_STATE_t KeyMUState = btn_Get_State(KEY_MOTOR_UP);  /*按键的事件掉电会触发长按的功能*/
    BTN_STATE_t KeyMDState = btn_Get_State(KEY_MOTOR_DOWN);
//	system_Communication_None();   /* 故障状态直接将上位机指令为空闲会出问题 */
    /*过压\欠压\过热故障恢复后,退出故障状态*/

    if(system_Get_Fault(FAULT_ALL) == 0)
    {
		if(mc_app_Get_State(MOTOR1) == e_mas_idle)
		{
			system_Communication_None();
			system_FSM_StateJump(pSystem, E_SYS_STATE_IDLE);
			return;
		}
    }else
    {
		/*判断电机位置丢失和hall异常*/
        if(system_Get_Fault(FAULT_M1_HAB | FAULT_POS))
        {
			if(pSystem->SysCon.Sys_ResetMode == E_DETECTION_SIGNAL)
			{
				
			}else
			{
				SYSTEM_SET_FLAG(pSystem->FaultFlag, FAULT_POS);//HALL异常发生后,强制置故障标志用于输出故障信号
			}
            pSystem->ZeroFound = 0;     
        }
    }
	/*上位机触发配置功能 程序从空闲状态跳入配置初始化状态*/
	if(SYSTEM_GET_FLAG(hSystemFlagCfg->EnterConfigFlag,SYS_CFG_ENTER_CFG_FLAG))
	{
		SYSTEM_CLR_FLAG(hSystemFlagCfg->EnterConfigFlag,SYS_CFG_ENTER_CFG_FLAG);
		system_FSM_StateJump(pSystem, E_SYS_CONFIG_INIT);
		return;
	}
	/*等待电机停止*/
    if(pSystem->Step == 0)
    {
        /*电机停止*/
        if(mc_app_Get_State(MOTOR1) != e_mas_idle)
        {
            mc_app_Set_Single_Motor_Cmd(MOTOR1, e_mac_stop, 0);
        }else
        {
			pSystem->RunDir = DIR_STOP;
            SYSTEM_CLR_FLAG(pSystem->MotorFlag, M1_MOVE | M2_MOVE);
            /*存储flash数据*/
			pSystem->Step++;
        }
    }else if(pSystem->Step == 1)
	{
		/*判断是否掉电，不是掉电模式会检测是否清除故障*/
		if(pSystem->BusVoltageMV  < POWER_DOWN_SAVE_FLASH)
		{
			system_Communication_None();
			pSystem->PowerDownSaveFlash = 1;
		}else
		{
			if(pSystem->PowerOnResetFlag == 1)  /* 配置以后需要复位，复位需要直接进入复位状态 */
			{
				pSystem->PowerOnResetFlag = 0;
				pSystem->Step++;
			}
			if(system_Get_LongKey() || (pSystem->ModbusCmd == e_mmc_clrfault) || (pSystem->CanCmd == e_can_clrfault))
			{
				if(system_Get_Fault(FAULT_POS | FAULT_M1_HAB))
				{
					pSystem->ZeroFound = 0;
					pSystem->Step++;
				}
				system_Clear_Motor_Fault(MOTOR1);
			}
		}
	}else if(pSystem->Step == 2)
	{
		/*需要复位模式下发送复位指令进入复位状态*/
		if(pSystem->SysCon.Sys_ResetMode == E_DETECTION_ANOMALY)
		{
			if(((system_Get_Fault(FAULT_M1_ALL) == 0)&&(system_Communication_Reset() == 1)) || (system_Get_Key_Event() == 1)) /*复位需要先清除故障，接收到上位机的复位指令或按键执行复位*/
			{
				system_FSM_StateJump(pSystem, E_SYS_STATE_ZERO);
				return;
			}
		}
	}
	/*电压低于10v判断为掉电开始存flash*/
	if(pSystem->PowerDownSaveFlash  == 1)
	{	
		pSystem->PowerDownSaveFlash  = 0;
		(void)system_Save_Flash(pSystem, FS_MOTOR_SATE | FS_SYS_PARAM | FS_MOTOR_LIMIT);
	}
}
/*状态任务-系统设置状态(eg: 记忆位置)*/
void system_Settings_Handler(void* System)
{
//  SYSTEM_t* pSystem = System;
//  MOTOR_POS_t ColumnHallPos = 0;
//  int32_t ReadMotorParam = 0;
//  uint8_t SaveFlag = 0;
//  static SETPOS_TYPE_t s_SetType = E_READY_TO_SET;
//  MOTOR_POS_t MemoryPosHall[10] = {0};
//
//  /*手控器显示*/
//  HSLedDisplaySetting(s_SetType);
//
//  /*初始化*/
//  if(pSystem->Step == 0)
//  {
//      s_SetType = E_READY_TO_SET;
//      timer_Set_SW_Timer_AlarmTime(SW_TIMER_0, 2000);//SW_TIMER_0:退出设置状态计时
//      timer_ResetStart_SW_Timer(SW_TIMER_0);
//      pSystem->Step++;
//  }
//  /*将当前位置设置为记忆位置*/
//  else if(pSystem->Step == 1)
//  {
//      mc_app_Read_Param(MOTOR1, e_map_fdbkpos, &ReadMotorParam);
//      if(btn_Match_Event(KEY_1, E_BTN_EVT_PRESS, 0))
//          SaveFlag = E_SET_MEMORY_POS_1;
//      else if(btn_Match_Event(KEY_2, E_BTN_EVT_PRESS, 0))
//          SaveFlag = E_SET_MEMORY_POS_2;
//      else if(btn_Match_Event(KEY_3, E_BTN_EVT_PRESS, 0))
//          SaveFlag = E_SET_MEMORY_POS_3;
//      else if(btn_Match_Event(KEY_4, E_BTN_EVT_PRESS, 0))
//          SaveFlag = E_SET_MEMORY_POS_4;
//      if(SaveFlag)
//      {
//          system_Set_Column_SpecificPos(COLUMN_POS_MEMORY1 + (SaveFlag - E_SET_MEMORY_POS_1), system_Column_HallData_2_Pos(ReadMotorParam));
//          s_SetType = SaveFlag;
//          SYSTEM_SET_FLAG(pSystem->SaveIntoFlash, FS_MOTOR_MEMORYPOS);
//          pSystem->MemoryPosSetFlag |= (1 << (SaveFlag - E_SET_MEMORY_POS_1));
//      }
//      /*记忆位置存储到flash*/
//      if(system_Save_Flash(pSystem, FS_MOTOR_MEMORYPOS))
//      {
//          timer_Set_SW_Timer_AlarmTime(SW_TIMER_0, 1000);//设置完成后,延时显示1s
//          timer_ResetStart_SW_Timer(SW_TIMER_0);
//      }
//  }

//  /*定时退出当前状态*/
//  if(timer_Get_SW_Timer_Event(SW_TIMER_0, SW_TIMER_EVT_ALARM))
//  {
//      timer_Abort_SW_Timer(SW_TIMER_0);
//      system_FSM_StateJump(pSystem, E_SYS_STATE_IDLE);
//      return;
//  }
}
/*状态任务-设置当前位置为零位*/
void system_SetZeroPos_Handler(void* System)
{
    SYSTEM_t* pSystem = System;
    int32_t ReadParam[MOTOR_NB] = {0};
    MOTOR_POS_t ColumnHallPos = 0;
    float ColumnmmPos = 0;
 
    float ColumnPosZero = 0;  
    
    //更新推杆当前位置
    ColumnPosZero = system_Get_Column_SpecificPos(COLUMN_POS_ZERO);
    
    if(pSystem->Step == 0)
    {
        mc_app_Read_Param(MOTOR1, e_map_fdbkpos, &ReadParam[0]);
        ColumnHallPos = system_Column_Pos_2_HallData(ColumnPosZero);
        if(ColumnHallPos != ReadParam[0])
        {
            ColumnmmPos = system_Column_HallData_2_Pos(ReadParam[0]);
            system_Set_Column_SpecificPos(COLUMN_POS_ZERO, ColumnmmPos);
            system_FSM_StateJump(pSystem, E_SYS_STATE_IDLE);
        }else
        {
            system_FSM_StateJump(pSystem, E_SYS_STATE_IDLE);
        }
    }
    /*电机运行时异常(运行时不检测过热)-急停*/
    if(system_Get_Fault(FAULT_MOTOR_ALL))
    {
		SYSTEM_SET_FLAG(pSystem->SaveIntoFlash, FS_MOTOR_SATE);
        system_FSM_StateJump(pSystem, E_SYS_STATE_FAULT);
		return;
    }
    /*电机运行时异常(运行时不检测过热)-急停*/
    else if(system_Get_Fault(FAULT_OVV | FAULT_UDV))
    {
        SYSTEM_SET_FLAG(pSystem->SaveIntoFlash, FS_MOTOR_SATE);
        system_FSM_StateJump(pSystem, E_SYS_STATE_FAULT);
		return;
    }
    
}

/*系统状态机入口*/
void system_FSM_Task(void)
{
    SystemStateHandler[System.State](&System);
}
/********************************函数定义************************************
*函数名:

*函数功能描述: 系统消息处理-接收处理回调函数

*函数参数: 无

*函数返回值: 无

*备注:
*****************************************************************************/

//#if (PROTOCOL_TYPE == MODBUS_PROTOCOL)
/*modbus接口应用处理回调*/
int8_t system_msgHandler_MB_AppCB03(uint8_t* RcvData, uint8_t Len)
{
    uint8_t FunCode = RcvData[MB_PDU_OFFSET_FUNC];
    uint16_t RegAddr = 0;
    uint16_t RegNb = 0;

    uint16_t RegValueStart = 0;
    int32_t Value32 = 0;
    float Motor_PosMM = 0;
    float Motor_Spd_mmps = 0;
    uint8_t Motor_Dir = 0;
    uint8_t Motor_Fault = 0;
    if((hModbusLink.SlaveAddr != RcvData[MB_ADU_OFFSET_ADDR])&&(RcvData[MB_ADU_OFFSET_ADDR] != MB_ADDR_BD))
    {
        hMsgHandler[0].Slave_Flag = 1;
        return -1;
    }else
    {
        hMsgHandler[0].Slave_Flag = 0;
    }
    if(FunCode == MB_FUNC_READ_HOLDING_REG)
    {
        RegAddr = (RcvData[MB_PDU_OFFSET_FUNC16_REGADDR] << 8) | RcvData[MB_PDU_OFFSET_FUNC16_REGADDR + 1];
        RegNb = (RcvData[MB_PDU_OFFSET_FUNC03_REGNB] << 8) | RcvData[MB_PDU_OFFSET_FUNC03_REGNB + 1];
    }
    for(uint16_t i = 0; i < RegNb; i++)
    {
        switch(RegAddr)
        {
            //从设备地址
            case MBREG_MOTOR_SLAVE_ADDR:
                modbus_Write_1Reg(g_KVPTable, MBREG_MOTOR_SLAVE_ADDR, hModbusLink.SlaveAddr);
                break;

            //电机速度
            case MBREG_MOTOR_RPM:
                if(MC_RET_OK == mc_app_Read_Param(MOTOR1, e_map_fdbkspd, &Value32))
                {
                    Motor_Spd_mmps = system_MotorRPM_2_ColumnSpeed(Value32);
                    modbus_Write_1Reg(g_KVPTable, MBREG_MOTOR_RPM, Motor_Spd_mmps);
                }
                break;

            //电机当前位置
            case MBREG_MOTOR_FDBKPOS:
                if(MC_RET_OK == mc_app_Read_Param(MOTOR1, e_map_fdbkpos, &Value32))
                {
                    Motor_PosMM = system_Column_HallData_2_Pos(Value32);
                    modbus_Write_1Reg(g_KVPTable, MBREG_MOTOR_FDBKPOS, Motor_PosMM);
                }
                break;

            //电机当前状态
            case MBREG_MOTOR_STATE:
                if(MC_RET_OK == mc_app_Read_Param(MOTOR1, e_map_dir, &Value32))
                {
                    if(Value32 == 0)
                        Motor_Dir = 0x03;
                    else if(Value32 == 1)
                        Motor_Dir = 0x01;
                    else
                        Motor_Dir = 0x02;
                    modbus_Write_1Reg(g_KVPTable, MBREG_MOTOR_STATE, Motor_Dir);
                }
                if(System.State == E_SYS_STATE_ZERO || System.State == E_SYS_STATE_FAULT)
                {
                    Motor_Fault = 0x04;
                    if(SYSTEM_GET_FLAG(System.FaultFlag, FAULT_M1_OVC))
                        Motor_Fault = 0x05;
                    if(SYSTEM_GET_FLAG(System.FaultFlag, FAULT_M1_HAB))
                        Motor_Fault = 0x06;
                    if(SYSTEM_GET_FLAG(System.FaultFlag, FAULT_UDV))
                        Motor_Fault = 0x07;
                    if(SYSTEM_GET_FLAG(System.FaultFlag, FAULT_OVV))
                        Motor_Fault = 0x08;
					if(SYSTEM_GET_FLAG(System.FaultFlag, FAULT_OVT))
                        Motor_Fault = 0x09;
                    modbus_Write_1Reg(g_KVPTable, MBREG_MOTOR_STATE, Motor_Fault);
                }
                break; 

            default:
                break;
        }
        RegAddr++;
        RegValueStart += 2;
    }
    return 1;
}  
/********************************函数定义************************************
*函数名:

*函数功能描述: 系统消息处理-接收处理回调函数

*函数参数: 无

*函数返回值: 无

*备注:
*****************************************************************************/
/*modbus接口应用处理回调*/
int8_t system_msgHandler_MB_AppCB(uint8_t* RcvData, uint8_t Len)
{
    uint8_t FunCode = RcvData[MB_PDU_OFFSET_FUNC];
    uint16_t RegAddr = 0;
    uint16_t RegNb = 0;
    int16_t RegValue = 0;
    uint16_t RegValueStart = 0;
    if((hModbusLink.SlaveAddr != RcvData[MB_ADU_OFFSET_ADDR])&&(RcvData[MB_ADU_OFFSET_ADDR] != MB_ADDR_BD))
    {
        hMsgHandler[0].Slave_Flag = 1;
        return -1;
    }else
    {
        hMsgHandler[0].Slave_Flag = 0;
    }
    if(FunCode == MB_FUNC_WRITE_1_REG)
    {
        //(0x06)写单个寄存器
        RegValueStart = MB_PDU_OFFSET_FUNC06_REGVALUE;
        RegAddr = (RcvData[MB_PDU_OFFSET_FUNC06_REGADDR] << 8) | RcvData[MB_PDU_OFFSET_FUNC06_REGADDR + 1];
        RegNb = 1;
    }else if(FunCode == MB_FUNC_WRITE_REGS)
    {
        //(0x10)写多个寄存器
        RegValueStart = MB_PDU_OFFSET_FUNC16_REGVALUE;
        RegAddr = (RcvData[MB_PDU_OFFSET_FUNC16_REGADDR] << 8) | RcvData[MB_PDU_OFFSET_FUNC16_REGADDR + 1];
        RegNb = (RcvData[MB_PDU_OFFSET_FUNC16_REGNB] << 8) | RcvData[MB_PDU_OFFSET_FUNC16_REGNB + 1];
    }
    for(uint16_t i = 0; i < RegNb; i++)
    {
        RegValue = (RcvData[RegValueStart] << 8) | RcvData[RegValueStart + 1];
        switch(RegAddr)
        {
            //从设备地址
            case MBREG_MOTOR_SLAVE_ADDR:
                if((RegValue >= 0) && (RegValue < 128))
                {
                    hModbusLink.LastSlaveAddr = hModbusLink.SlaveAddr;  //记录从机上次的地址信息，为了解决从机在切换地址时没有应答的bug
                    hModbusLink.SlaveAddr = RegValue;
                    SYSTEM_SET_FLAG(System.SaveIntoFlash, FS_SYS_PARAM);
					sys_cfg_NodeSlaveAddr(hModbusLink.SlaveAddr);
                }
                break;

            //电机控制 1：上升  2：下降  3：停止
            case MBREG_MOTOR_CMD:
                if(RegValue == 1)
                    System.ModbusCmd = e_mmc_up;
                else if(RegValue == 2)
                    System.ModbusCmd = e_mmc_dn;
                else if(RegValue == 3)
                    System.ModbusCmd = e_mmc_stop;    
                break;

            //电机复位
            case MBREG_MOTOR_RESET:
                if(RegValue == 1)
                    System.ModbusCmd = e_mmc_reset;
                break;

            //电机运行到目标位置             设置目标位置的范围
            case MBREG_MOTOR_TARGETSPEED_POS:
                System.ModbusColumnPos = RegValue;
                System.ModbusCmd = e_mmc_goto;
                break; 

            //电机设置当前位置为零位
            case MBREG_MOTOR_FDBKPOS_ZERO:
                if(RegValue == 0)
                    System.ModbusCmd = e_mmc_poszero;
                break;

            //电机电机速度
            case MBREG_MOTOR_RPM:
                if(RegValue > (system_Speedmmps_Max()))
                    RegValue =(system_Speedmmps_Max());
                else if(RegValue < (system_Speedmmps_Min()))
                    RegValue = (system_Speedmmps_Min());
                System.MotorSpeed = system_ColumnSpeed_2_MotorRPM(RegValue);
                break;
			/* 清除电机故障 */
			case MBREG_MOTOR_CLR_FAULT:
				system_Clear_Motor_Fault(MOTOR1);	//只有电机故障可以被清除,系统故障无法清除
				System.ModbusCmd = e_mmc_clrfault;  /* 清除故障以后给命令清零，防止在清除命令之前有其他命令保存 */
				break;
            default:
                break;
        }
        RegAddr++;
        RegValueStart += 2;
    }
    return 1;
}

/********************************函数定义************************************
*函数名:

*函数功能描述: modbus-公共

*函数参数: 无

*函数返回值: 无

*备注:
*****************************************************************************/
/*获取句柄*/
MSG_HANDLER_t* msgHandler_Get_Handle(uint8_t Interface)
{
    return &hMsgHandler[Interface];
}
/*装填发送数据*/
int8_t msgHandler_hInit(MSG_HANDLER_t *MsgHandler, uint8_t Interface, uint8_t SlaveFlag)
{
    QUEUE_t *Queue = {0};

    MsgHandler->Interface = Interface;
    MsgHandler->Slave_Flag = SlaveFlag;
    if(QOP_SUCCESS == queue_Create(&Queue))
    {
        MsgHandler->QSend = Queue;
    }else
    {
        return MSG_RET_ERR_MA;
    }
    return MSG_RET_OK;
}

/********************************函数定义************************************
*函数名:

*函数功能描述: 消息处理器-发送处理

*函数参数: 无

*函数返回值: 无

*备注:
*****************************************************************************/
/*发送数据(未打包)放入队列*/
int8_t msgHandler_Pop_SendData(uint8_t Interface, uint8_t *Data, uint8_t DataLen)
{
    MSG_HANDLER_t *MsgHandler = msgHandler_Get_Handle(Interface);

    if(!Data || !DataLen)
        return MSG_RET_ERR_PARAM;
    if(MsgHandler->Slave_Flag == 0)
    {
        if(queue_Push(MsgHandler->QSend, Data, DataLen) != QOP_SUCCESS)
        {
            return QOP_ERR_DATA;
        }
        return MSG_RET_OK;
    }else
    {
        return QOP_ERR_DATA;
    } 
}
/*判断接口当前是否可发送数据*/
BOOL msgHandler_Send_Ready(MSG_HANDLER_t *MsgHandler)
{
    uint8_t Ready = 0;
    if(uart_Transmit_Ready(hUartRS485.Ins.Channel) == TRUE)
        Ready++;
    if(modbus_Send_Ready(&hModbusLink) == TRUE)
        Ready++;
    return (BOOL)(Ready == 2);
}
/*发送数据*/
int8_t msgHandler_Send(MSG_HANDLER_t *MsgHandler)
{
    /*从发送队列获取未打包数据*/
    uint8_t *Data = queue_Get_HeadNode_Data(MsgHandler->QSend);
    uint8_t DataLen = queue_Get_HeadNode_DataSize(MsgHandler->QSend);
    if((modbus_rtu_Pack(&hModbusLink, Data, DataLen) == MB_RET_OK))
    {
        queue_Pop(MsgHandler->QSend, 0, 0);
        //更新指针,指向打包后数据
        Data = hModbusLink.MsgSend.Msg;
        DataLen = hModbusLink.MsgSend.MsgLen;
    }else
    {
        queue_Pop(MsgHandler->QSend, 0, 0);
        return MSG_RET_ERR_PACK;    //数据错误,不发送
    }
    uart_adapter_Transmit_Polling(hUartRS485.Ins.Channel, Data, DataLen);
    return MSG_RET_OK;
}
/*判断接口是否发送完成*/
BOOL msgHandler_Send_Cplt(MSG_HANDLER_t *MsgHandler)
{
    BOOL Ret = FALSE;
    if(uart_Get_State(hUartRS485.Ins.Channel, UART_TC))
    {
        uart_Clr_State(hUartRS485.Ins.Channel, UART_TC);
        Ret = TRUE;
    }
    if(Ret == TRUE)
    {
        modbus_Set_XfFlag(&hModbusLink, MB_XF_SEND_CPLT);
    }
    return Ret;
}
/*发送处理器*/
void msgHandler_Send_Handler(MSG_HANDLER_t *MsgHandler)
{
    /*引入State互斥的原因: 由于硬件通过异步中断发数据,中断中就可置位msgHandler_Send_Ready()为真判断所需的硬件发送就绪标志!
      如果不加入互斥保证判断"发送完成"后再判断是否"可以发送",当QSend存在2条以上数据时,"可以发送"判断连续满足,导致连发2包粘包*/
    if(MsgHandler->State == 0)
    {
        
        //可以发送
        if(msgHandler_Send_Ready(MsgHandler) && (!queue_Empty(MsgHandler->QSend)))
        {
            gpio_adapter_Set_Pin(UART_485_DIR_PORT,UART_485_DIR_PIN);
            if(msgHandler_Send(MsgHandler) == MSG_RET_OK)
                MsgHandler->State = 1;
        }
    }else
    {
        //发送完成
        if(msgHandler_Send_Cplt(MsgHandler))
        {
            MsgHandler->State = 0;
        }
    }
}

/********************************函数定义************************************
*函数名:

*函数功能描述: modbus通讯相关接收函数处理

*函数参数: 无

*函数返回值: 无

*备注:
*****************************************************************************/
/*判断接口是否接收完成*/
BOOL msgHandler_Rcv_Cplt(MSG_HANDLER_t *MsgHandler, uint8_t *RcvData, uint16_t *RcvLen)
{
    BOOL Ret = FALSE;
    if(uart_Get_Receive(hUartRS485.Ins.Channel, RcvData, RcvLen) == UART_RET_OK)
    {
        Ret = TRUE;
    }
    return Ret;
}
/*链路层解析*/
int8_t msgHandler_Parse_RcvMsg(MSG_HANDLER_t *MsgHandler, uint8_t *RcvMsg, uint16_t MsgLen)
{
    int8_t Ret = 0;
    Ret = modbus_rtu_Unpack(&hModbusLink, RcvMsg, (uint8_t)MsgLen);   //强转uint8_t：modbus帧最大长度为255.
    if(Ret == MB_RET_OK)
    {
        modbus_Set_XfFlag(&hModbusLink, MB_XF_RCV_CPLT);
    }else if(Ret == MB_RET_ERR_CRC)
    {
        return MSG_RET_ERR_CRC;
    }
    return MSG_RET_OK;
}
/*应用层处理*/
int8_t msgHandler_Msg_Handler(MSG_HANDLER_t *MsgHandler, uint8_t *RcvMsg, uint16_t MsgLen)
{
    modbus_Func_Handler(&hModbusLink, MsgHandler->Interface);
    return MSG_RET_OK;
}
/*接收处理器*/
void msgHandler_Receive_Handler(MSG_HANDLER_t *MsgHandler)
{
    uint8_t ReData[100] = {0};
    uint16_t ReByteNb = 0;
    gpio_adapter_Reset_Pin(UART_485_DIR_PORT,UART_485_DIR_PIN);
    /*判断数据接收完成*/
    if(msgHandler_Rcv_Cplt(MsgHandler, ReData, &ReByteNb))
    {
        if(msgHandler_Parse_RcvMsg(MsgHandler, ReData, ReByteNb) == MSG_RET_OK)
        {
            msgHandler_Msg_Handler(MsgHandler, 0, 0);
        }
    }
}


/*modbus通讯*/
void System_Modbus_Task(void)
{
    /*队列模块*/
//    queue_Test();

    /*消息处理器模块*/
//    msgHandler_Test();
    msgHandler_Send_Handler(&hMsgHandler[0]);
    msgHandler_Receive_Handler(&hMsgHandler[0]);

    /*链路层控制器模块*/
    modbus_Host_Controller(&hModbusLink);
    modbus_Slave_Controller(&hModbusLink);
    modbus_Reg_CallBack_FuncHandlerCB(&hModbusLink, system_msgHandler_MB_AppCB, MB_FUNC_WRITE_1_REG);
    modbus_Reg_CallBack_FuncHandlerCB(&hModbusLink, system_msgHandler_MB_AppCB03, MB_FUNC_READ_HOLDING_REG);
    /*物理层控制器模块*/
//    uart_Test();
}

/*根据系统状态,更新CanOpen对象字典*/
void system_Update_OD(void)
{
	//uint32_t Temp = 0;
	
	/*电机状态-OD_SI_M_STATE*/
	if(System.RunDir == DIR_UP)
		CO_SET_OD(OD_SI_M_STATE, e_cms_up);
	else if(System.RunDir == DIR_DOWN)
		CO_SET_OD(OD_SI_M_STATE, e_cms_dn);	
	else	//DIR_STOP
		CO_SET_OD(OD_SI_M_STATE, e_cms_stop);
	
	/*系统状态-OD_SI_SYS_STATE*/
	if(System.FaultFlag)
	{
		if(System.FaultFlag & FAULT_M1_ALL)	//优先报电机异常
		{
			if(System.FaultFlag & FAULT_M1_OVC)
				CO_SET_OD(OD_SI_SYS_STATE, e_css_fault_ovc);
			else if(System.FaultFlag & FAULT_M1_HAB)
				CO_SET_OD(OD_SI_SYS_STATE, e_css_fault_hall);
		}else	//系统异常
		{
			if(System.FaultFlag & FAULT_UDV)
				CO_SET_OD(OD_SI_SYS_STATE, e_css_fault_udv);
			else if(System.FaultFlag & FAULT_OVV)	
				CO_SET_OD(OD_SI_SYS_STATE, e_css_fault_ovv);
			else if(System.FaultFlag & FAULT_OVT)	
				CO_SET_OD(OD_SI_SYS_STATE, e_css_fault_hot);
			else if(System.FaultFlag & FAULT_POS)
				CO_SET_OD(OD_SI_SYS_STATE, e_css_lost_pos);
		}
	}else
	{
		if(System.SysCon.Sys_ResetMode == E_DETECTION_SIGNAL)
		{
			CO_SET_OD(OD_SI_SYS_STATE, e_css_normal);
		}else
		{
			if(System.ZeroFound)
			{
				CO_SET_OD(OD_SI_SYS_STATE, e_css_normal);
			}
		}
	}
	
	/*推杆位置-OD_SI_FDBK_POS*/
	CO_SET_OD(OD_SI_FDBK_POS, (uint32_t)(System.ColumnPosMM[0] * 10));
}    

/*系统回调函数-更新对象字典对应的系统操作*/
void system_CB_CanOpenSdoTx(uint8_t Index)
{
	uint32_t ColumSpdLimit = 0;	//1=0.1mm/s

	switch(Index)
	{
		case OD_SI_TRG_SPD:
			SYSTEM_SET_FLAG(System.SaveIntoFlash, FS_SYS_PARAM);
			ColumSpdLimit = (system_Speedmmps_Min()) * 10;
			if(CO_GET_OD(OD_SI_TRG_SPD) < ColumSpdLimit)
				CO_SET_OD(OD_SI_TRG_SPD, ColumSpdLimit);
			ColumSpdLimit = (system_Speedmmps_Max()) * 10;
			if(CO_GET_OD(OD_SI_TRG_SPD) > ColumSpdLimit)
				CO_SET_OD(OD_SI_TRG_SPD, ColumSpdLimit);
			System.MotorSpeed = system_ColumnSpeed_2_MotorRPM((float)CO_GET_OD(OD_SI_TRG_SPD) / 10);
			break;

		case OD_SI_CMD_M_UP:
			System.CanCmd = e_can_up;
			break;

		case OD_SI_CMD_M_DN:
			System.CanCmd = e_can_dn;
			break;
		
		case OD_SI_CMD_M_STOP:
			System.CanCmd = e_can_stop;
			break;
		
		case OD_SI_CMD_M_GOTO:
			System.CanCmd = e_can_goto;
			break;
		
		case OD_SI_CLR_FAULT:
			system_Clear_Motor_Fault(MOTOR1);	//只有电机故障可以被清除,系统故障无法清除
			System.CanCmd = e_can_clrfault;		/* 清除故障以后给CAN命令状态为none */
			break;
		
		case OD_SI_HEARTBEAT:
			SYSTEM_SET_FLAG(System.SaveIntoFlash, FS_SYS_PARAM);
			break;
		
		case OD_SI_NODEID:
			SYSTEM_SET_FLAG(System.SaveIntoFlash, FS_SYS_PARAM);
			can_adapter_SetFilter_IDMask(CAN1, CanFilterSel2, sCONode.NodeID, CO_ID_MASK_FUNC);
			sys_cfg_NodeSlaveAddr(sCONode.NodeID);
			break;
		case OD_SI_CMD_M_RESET:
			System.CanCmd = e_can_reset;
			break;
		default:
			break;
	}
}
/*CanOpen通讯*/
void system_Com_Task(void)
{
	/*接收超时处理*/
	can_adapter_BusRecover(CAN1);
	/*更新对象字典*/
	system_Update_OD();
	/*接收消息处理*/
	co_RcvHandle(&sCONode);
	/*发送心跳消息*/
	co_HeartBeat(&sCONode);
}
//#endif

//CANJ1939
void system_CJ_Task(void )
{
	/*接收超时处理*/
	can_adapter_BusRecover(CAN1);
	/*更新参数字典*/
	update_para();
	/*接收消息处理*/	
	cj_RcvHandle();
	/*消息发送*/
	cj_initiate_send();
}

/*设置can控制命令*/
void system_set_CanCmd(can_m_cmd_t CanCmd)
{
	if(CanCmd == e_can_up)
	{
		SYSTEM_CLR_FLAG(System.MotorLockedRotor, M_LOCKED_FLAG);
	}
	System.CanCmd = CanCmd;
}
/*读取已完成复位标志*/
uint8_t system_get_ZeroFound(void)
{
	return System.ZeroFound;	
}
/*获取故障标志*/
uint16_t system_get_FaultFlag(void)
{
	return System.FaultFlag;
}
/*获取推杆当前位置*/
float system_get_columnPosMM(void)
{
	return System.ColumnPosMM[0];
}
/*获取限位标志*/
uint16_t system_get_LimitFlag(void)
{
	return System.LimitFlag;
}
//获取当前手刹是否拉紧
uint8_t system_get_LockedFlag(void)
{
	return System.MotorLockedRotor;
}

/*获取刹车状态*/
uint8_t system_get_BrakeState(void)
{
	return Brake_State;
}
/********************************函数定义************************************
*函数名:

*函数功能描述: 系统功能-入口函数

*函数参数: 无

*函数返回值: 无

*备注:
*****************************************************************************/
/*上位机通讯入口*/
void system_Commsg_Init(void)
{
	syscon_cfg_handle_t hSystemConfig = sys_cfg_Hadnle();

	UART_INS_t UartConfig = {UART_485, UART3};
	uart_hInit(&hUartRS485, &UartConfig, 0);
	/*消息接口初始化-链路层*/
#if 0   //主机
	modbus_hInit(&hModbusLink, MB_NODE_HOST, 0, g_KVPTable);
#else   //从机
	modbus_hInit(&hModbusLink, MB_NODE_SLAVE, hSystemConfig.Config_NodeSlaveAddr, g_KVPTable); // MB_NODE_SLAVE_ADDR  SysConfig->Config_NodeSlaveAddr
	modbus_Reg_CallBack_Ack(&hModbusLink, msgHandler_Pop_SendData);
#endif
	msgHandler_hInit(&hMsgHandler[0], 0, 0);

	/*can控制器初始化*/
	can_hInit(&hCANController, M4_CAN, CAN1);
	can_adapter_Clr_RB(CAN1);	//销毁RB中已有的数据,防止对应用层起作用
	
	/*CanOpen节点初始化*/		
	co_hInit(&sCONode, hSystemConfig.Config_NodeSlaveAddr);
	co_SetNodeState(&sCONode, e_ns_pre_operational);
	co_sdo_tx_RegWriteODCallback(&sCONode, system_CB_CanOpenSdoTx);

}
/* 底层配置初始化 */
void system_MotorInit(void)
{
	syscon_cfg_handle_t hSystemConfig = sys_cfg_Hadnle();
	mc_app_ModifyHallDir(MOTOR1, hSystemConfig.Config_HallDirectionSel);
	mc_app_ModifyDrvDir(MOTOR1, hSystemConfig.Config_PhaseDirectionSel);
	mc_app_Write_Param(MOTOR1, e_map_ocp_thh, hSystemConfig.Config_OvcValue);
}
	

/*系统初始化入口*/
void system_Init(void)
{
#if (MCU_TYPE == MCU_TYPE_STM32)
    flash_adapter_Init();
    timer_IT_Enable(16, TIMER_IT_UPDATE);
    adc_adapter_Calibration();
#endif
//  /*adc_adapter模块初始化(系统)*/
//  ADCH_t  MSPD_ADCH = {ADCH_MSPD_ADC, ADCH_MSPD_ADCH, ADCH_MSPD_PORT, ADCH_MSPD_PIN};
//  adc_adapter_hInit(&hADCChannalMSR, &MSPD_ADCH);
//  adc_adapter_Set_Channal_SmpTime(ADCH_MSPD_ADCH, 10);
//  adc_adapter_Set_Channal_SmpIntervalTime(ADCH_MSPD_ADCH, 5);
//  adc_adapter_Channel_Enable(ADCH_MSPD_ADCH);

    // ADCH_t  VM_ADCH = {ADCH_VM_ADC, ADCH_VM_ADCH, ADCH_VM_PORT, ADCH_VM_PIN};
    // adc_adapter_hInit(&hADCChannalMBV, &VM_ADCH);
    // adc_adapter_Set_Channal_SmpTime(ADCH_VM_ADCH, 500);
    // adc_adapter_Set_Channal_SmpIntervalTime(ADCH_VM_ADCH, 8);
    // adc_adapter_Channel_Enable(ADCH_VM_ADCH);

	ADCH_t  HOT_ADCH = {ADCH_TEMP_ADC, ADCH_TEMP_ADCH, ADCH_TEMP_PORT, ADCH_TEMP_PIN};
	adc_adapter_hInit(&hADCChannalTemp, &HOT_ADCH);
	adc_adapter_Set_Channal_SmpTime(ADCH_TEMP_ADCH, 100);
	adc_adapter_Set_Channal_SmpIntervalTime(ADCH_TEMP_ADCH, 2);
	adc_adapter_Channel_Enable(ADCH_TEMP_ADCH);

    // ADCH_t  VM_ADIVM = {ADCH_IVM_ADC, ADCH_IVM_ADCH, ADCH_IVM_PORT, ADCH_IVM_PIN};
    // adc_adapter_hInit(&hADCChannalIVM, &VM_ADIVM);
    // adc_adapter_Set_Channal_SmpTime(ADCH_IVM_ADCH, 80);
    // adc_adapter_Set_Channal_SmpIntervalTime(ADCH_IVM_ADCH,1);
    // adc_adapter_Channel_Enable(ADCH_IVM_ADCH);

    (void)btn_Init();

    mc_app_Init();

	system_Commsg_Init();
	
	sys_cfg_UartConfigInit();
	
	system_MotorInit();
}
/*上位机通讯入口*/
void system_Commsg_Task(void)
{
	if(System.SysCon.Sys_CommunicationType == E_MODBUS)
	{
		System_Modbus_Task();
		system_Update_MBReg();
	}else if(System.SysCon.Sys_CommunicationType == E_CAN)
	{
		system_Com_Task();
	}
	/* 上位机通讯处理函数 */
	sys_cfg_MsgUartConfigHandler(&hUartData);
}

/*看门狗喂狗函数*/
void system_SwdtTask(void)
{
	if(g_SwdtCounter >= 200)
	{
		g_SwdtCounter = 0;
		//gpio_adapter_Toggle_Pin(GPIO_LED_PORT, GPIO_LED_PIN); //hz test
		SWDT_RefreshCounter();		/*看门狗喂狗函数*/
	}
}
/*测试入口*/
void system_Test(void)
{
//  /*调试模块测试*/
//  debug_Test();
//
//  /*flash模块测试*/
//  flash_adapter_Test();

//  /*按钮模块测试*/
//  btn_Test();
	
	/*CAN控制器模块测试*/
//	can_Test();
	
//	/*mainLoop执行效率测试*/
//    gpio_adapter_Toggle_Pin(GPIO_LED2_PORT, GPIO_LED2_PIN);
	
	/*串口测试函数*/
//	sys_cfg_DeliveryData();
//	crc_Test();
}
/*系统后台入口*/
void system_Loop_Task(void)
{
	/*看门狗喂狗函数*/
	system_SwdtTask();
	/**/
//  btn_Loop_Task();

    /*系统交互信息*/
//    system_Signal_LoopTask();
	
    /*系统状态机任务*/
    system_FSM_Task();
	
	/*推杆位置更新*/
    system_Column_Update_Pos_Signal();
    
    /*电机控制任务*/
    system_Motor_Task();

    /*系统异常检测任务*/
    system_Check_Fault_Task();
    
	/*通讯任务*/
	system_Commsg_Task();

    /*测试任务(test only)*/
//    system_Test();


	
}
/*系统定时入口(250us调用1次)*/
void system_Timer_Task(void)
{
    static uint16_t _1msCnt = 0;

//    gpio_adapter_Toggle_Pin(GPIO_LED_PORT, GPIO_LED_PIN);
//    gpio_adapter_Set_Pin(TEST2_GPIO_Port, TEST2_Pin);   //20us高电平(128MHz)
    mc_app_Timer_250us();
    if(++_1msCnt >= 4)
    {
        _1msCnt = 0;
        g_Counter++;
		g_SwdtCounter++;
        System.HSSendTimer++;
        mc_app_Timer_1ms();
        //msgHandler_Timer_1ms();
        btn_Timer_Task_1ms();
        timer_SW_Timer_Run();
        system_Read_Column_Limit();
        //system_Read_MotorControl_Signal();
        if(System.State != E_SYS_STATE_INIT)
        {
//            system_Read_MC_Mode_Signal(1);
        }
		/*加上SYSTEM_RUN_LED_TIMEms的灯闪，表示系统正常运行*/
//		if(g_Counter >= SYSTEM_RUN_LED_TIME)
//		{
//			g_Counter = 0;

//		}
        modbus_Timer(&hModbusLink);
        co_HeartBeatTimer(&sCONode);
     
        System.CfgCount++;
		if(System.OVVFlag == 1)
		{
			System.OVVCount++;
		}
    }
}
/********************************函数定义************************************
*函数名:

*函数功能描述: 中断回调函数

*函数参数: 无

*函数返回值: 无

*备注:
*****************************************************************************/
#if (MCU_TYPE == MCU_TYPE_STM32)
void HAL_TIM_PeriodElapsedCallback(TIM_HandleTypeDef *htim)
{
    if(htim == &htim16)
    {
        system_Timer_Task();
    }
}
#elif (MCU_TYPE == MCU_TYPE_HC32_F0 || MCU_TYPE == MCU_TYPE_HC32_L1)
/*定时器中断*/
void TIM_Callback(void)
{
    /*溢出中断(10Hz)*/
    if(Bt_GetIntFlag(TIM0, BtUevIrq) == TRUE)
    {
        Bt_ClearIntFlag(TIM0, BtUevIrq);
        //system_Quit_Lowpower(FALSE);
        //gpio_adapter_Toggle_Pin(GPIO_TEST1_PORT, GPIO_TEST1_PIN);
    }

    /*溢出中断(4KHz)*/
    if(Bt_GetIntFlag(TIM1, BtUevIrq) == TRUE)
    {
        Bt_ClearIntFlag(TIM1, BtUevIrq);
        //i2c_adapter_Timer();
        system_Timer_Task();
    }
}
#elif (MCU_TYPE == MCU_TYPE_HC32_F4)
/*定时器中断ISR*/
void Timer01B_CallBack(void)
{
    if(Set == TIMER0_GetFlag(M4_TMR01, Tim0_ChannelB))
    {
        TIMER0_ClearFlag(M4_TMR01, Tim0_ChannelB);
        system_Timer_Task();
        // uart_Idle_Callback(UART3);
		// uart_Idle_Callback(UART1);
    }
    tickTimer_Update();
    /* 更新 UDS 计时器 */
    uds_ms_update();    
    adc_adapter_SampleInterval_Timer();
    isotp_ms_update();		
		//can_Timer_1ms(CAN1); 		
}
/*引脚中断ISR*/
void ExtInt_Callback(void)
{
    if(Set == EXINT_IrqFlgGet(M1_HALLA_EIRQ_CH))
    {
        EXINT_IrqFlgClr(M1_HALLA_EIRQ_CH);
        system_Set_MotorSpd_Signal();
    }
    if(Set == EXINT_IrqFlgGet(M1_HALLB_EIRQ_CH))
    {
        EXINT_IrqFlgClr(M1_HALLB_EIRQ_CH);
        system_Set_MotorSpd_Signal();
    }
    if(Set == EXINT_IrqFlgGet(M1_HALLC_EIRQ_CH))
    {
        EXINT_IrqFlgClr(M1_HALLC_EIRQ_CH);
        system_Set_MotorSpd_Signal();
    }
    mc_app_Trigger_Task_HallEdge();
}
/*UART接收中断ISR*/
void Uart_Callback_Rx(void)
{
    uart_Rx_Callback(UART3);
}
void Uart_MCU_Callback_Rx(void)
{
    uart_Rx_Callback(UART1);
}

/*UART错误中断ISR*/
void Uart_Callback_Err(void)
{
    uart_Err_Callback(UART3);
}
void Uart_MCU_Callback_Err(void)
{
    uart_Err_Callback(UART1);
}

/*UART发送中断ISR*/
void Uart_Callback_Tx(void)
{
    uart_TXE_Callback(UART3);
}
void Uart_MCU_Callback_Tx(void)
{
    uart_TXE_Callback(UART1);
}

/*UART发送完成中断ISR*/
void Uart_Callback_TC(void)
{
    uart_TC_Callback(UART3);
}
void Uart_MCU_Callback_TC(void)
{
    uart_TC_Callback(UART1);
}

/*UART空闲中断ISR*/
void Uart_Callback_Idle(void)
{
    TIMER0_Cmd(M4_TMR02, Tim0_ChannelA, Disable);
    uart_Idle_Callback(UART3);
}
void Uart_MCU_Callback_Idle(void)
{
    TIMER0_Cmd(M4_TMR01, Tim0_ChannelA, Disable);
    uart_Idle_Callback(UART1);
}


void CAN_RxIrqCallBack(void)
{
    CAN_RCV_FRAME_t rx_frame;
    uint32_t ext_id;
    static uint8_t isotp_buffer[ISOTP_BUFFER_SIZE];
    uint16_t isotp_len;
    int8_t isotp_ret;
    
    if(can_Err_Callback(CAN1) == CAN_RET_OK)
    {
        return;
    }
    
    if (can_Rx_Callback(CAN1) == CAN_RET_OK)
    {
        while (can_Get_Receive(CAN1, &rx_frame, 1) == CAN_RET_OK)
        {
            ext_id = rx_frame.ExtID & EXT_ID_MASK;
            
            isotp_ret = isotp_receive_frame(CAN1, ext_id, rx_frame.Data, 
                                            rx_frame.Cst.Control_f.DLC, 
                                            isotp_buffer, &isotp_len);
            
            if (isotp_ret == ISOTP_OK)
            {
                /* 添加调试打印 */
                // OTA_I("ISOTP_OK from interrupt: out_len=%d", isotp_len);
                uds_receive_handler(CAN1, ext_id, isotp_buffer, isotp_len);
            }
        }
    }
}

/*系统后台入口*/
void hz_loop(void)
{
	/*看门狗喂狗函数*/
	// system_SwdtTask();
    // /*系统状态机任务*/
    // system_FSM_Task();
	// /*推杆位置更新*/
    // system_Column_Update_Pos_Signal();
    // /*电机控制任务*/
    // system_Motor_Task();
    // delay_ms(1000);

    /* 电源极性->推杆位置->电机状态*/
    



    /*系统异常检测任务*/
    // system_Check_Fault_Task();
}



#endif
