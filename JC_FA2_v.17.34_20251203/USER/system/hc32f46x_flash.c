#include "hc32f46x_flash.h"
#include "main.h"
#include "stdint.h"

// 测试结果变量
volatile uint32_t flash_test_result = 0;

// FLASH编程模式
typedef enum
{
    PEMOD_READ_ONLY = 0,           // 只读模式
    PEMOD_SINGLE_PROGRAM = 1,      // 单编程模式
    PEMOD_SINGLE_PROGRAM_RB = 2,   // 单编程回读模式
    PEMOD_SEQUENCE_PROGRAM = 3,    // 连续编程模式
    PEMOD_SECTOR_ERASE = 4,        // 扇区擦除模式
    PEMOD_MASS_ERASE = 5,          // 全擦除模式
} FLASH_PEMOD;

//__at__IRAM3__
void HC32FLASH_Unlock(void)
{
    // 1. 解除FLASH的寄存器写保护 - 向EFM_FAPRT写入特定序列
    M4_EFM->FAPRT = 0x0123;
    M4_EFM->FAPRT = 0x3210;

    // 2. 设定编程擦写模式许可
    M4_EFM->FWMC |= (1UL << 0);              // EFM_FWMC.PEMODE=1
    // EFM_ErasePgmCmd(Enable);

    // 3. 总线占用控制（可选）
    // M4_EFM->FWMC &= ~(1UL << 8);             // FLASH编程擦除期间，总线被占用
    EFM_SetBusState(BusBusy);
}
//__at__IRAM3__
void HC32FLASH_Lock(void)
{
    // 1. 取消编程擦写模式许可
    M4_EFM->FWMC &= ~(1UL << 0);             // EFM_FWMC.PEMODE=0
    
    // 2. 重新上锁 - 向EFM_FAPRT写入0
    M4_EFM->FAPRT = 0x0000;
}

//__at__IRAM3__
HC32FLASH_STATUS HC32FLASH_GetStatus(void)
{
    uint32_t temp = M4_EFM->FSR;
    
    if (!(temp & (1UL << 8))) return HC32FLASH_BUSY;          // 忙
    else if (temp & (1UL << 1)) return HC32FLASH_WPRERR;      // 写保护错误
    else if (temp & (1UL << 2)) return HC32FLASH_PGAERR;      // 编程对齐错误
    else if (temp & (1UL << 0)) return HC32FLASH_PEWERR;      // 在擦写不许可模式下擦写FLASH
    else if (temp & (1UL << 5)) return HC32FLASH_COLERR;      // 读写访问错误
    else if (temp & (1UL << 3)) return HC32FLASH_PGMISMTCH;   // 单编程回读错误
    return HC32FLASH_OK;                                      // 操作完成
}

//__at__IRAM3__
__attribute__((section(".ramfunc"))) HC32FLASH_STATUS HC32FLASH_WaitDone(uint32_t time)
{
    HC32FLASH_STATUS status;
    uint32_t i;
    
    if (time < 1) time = 1;
    do
    {
        status = HC32FLASH_GetStatus();    // 获取状态
        if (status != HC32FLASH_BUSY) break; // 非忙，退出
        for (i = 0; i < 100; i++)
        {
            __NOP(); 
            __NOP(); 
            __NOP(); 
            __NOP(); 
            __NOP();
        }
        time--;
    } while (time);
    
    return status;
}

//__at__IRAM3__
void HC32FLASH_SetErasePgmMode(FLASH_PEMOD mode)
{
    M4_EFM->FWMC &= ~(0x7UL << 4);           // 清除之前配置 第4~6位清零，即PMODE[2:0] = 000
    M4_EFM->FWMC |= ((uint32_t)mode & 0x07UL) << 4;  // 设置新模式到PMODE[2:0] = mode
}

//__at__IRAM3__
__attribute__((section(".ramfunc"))) HC32FLASH_STATUS HC32FLASH_EraseSector(uint32_t u32Addr)
{
    HC32FLASH_STATUS status;

    //__disable_irq();

    // 步骤1: 解除FLASH的寄存器写保护
    HC32FLASH_Unlock();
    
    // 步骤2: 设定扇区擦除模式
    HC32FLASH_SetErasePgmMode(PEMOD_SECTOR_ERASE);
    
    // 步骤3: 对擦除地址写入数据（触发擦除）
    *(volatile uint32_t*)u32Addr = 0x00000000;
    
    // 步骤4: 等待FLASH处于空闲状态
    status = HC32FLASH_WaitDone(1000000);
    
    // 步骤5: 清除编程结束标志位
    M4_EFM->FSCLR = 0x3FUL;
    
    // 步骤6: 退出擦除模式并上锁
    HC32FLASH_SetErasePgmMode(PEMOD_READ_ONLY);
    HC32FLASH_Lock();
    
    //__enable_irq();

        
    return status;
}
//__at__IRAM3__
HC32FLASH_STATUS HC32FLASH_WritedWord_NoCheck(uint32_t u32Addr, uint32_t data)
{
    HC32FLASH_STATUS status;
    uint32_t FRMC_Temp;
    
    //__disable_irq();                       // 关闭中断
    M4_EFM->FSCLR = 0x3FUL;                   // 清除所有错误标记
    HC32FLASH_Unlock();                    // 解锁
    FRMC_Temp = M4_EFM->FRMC;                 // 记录之前寄存器值
    if (FRMC_Temp & (1UL << 16))           // 使能了缓存，则先关闭
    {
        M4_EFM->FRMC &= ~(1UL << 16);         // 关闭缓存
    }
    
    HC32FLASH_SetErasePgmMode(PEMOD_SINGLE_PROGRAM_RB); // 进入单编程回读模式
    *(volatile uint32_t*)u32Addr = data;   // 写入数据
    status = HC32FLASH_WaitDone(10000);    // 等待操作结束，最大10ms
    
    M4_EFM->FSCLR = 0x3FUL;                   // 清除所有错误标记
    HC32FLASH_SetErasePgmMode(PEMOD_READ_ONLY); // 退出编程模式
    if (FRMC_Temp & (1UL << 16))           // 使能了缓存
    {
        M4_EFM->FRMC |= (1UL << 16) | (1UL << 24); // 开启缓存并复位缓存
    }
    HC32FLASH_Lock();                      // 上锁
    //__enable_irq();                        // 使能中断

    
    EFM_DataCacheRstCmd(Disable);

    return status;
}

//__at__IRAM3__
__attribute__((section(".ramfunc"))) HC32FLASH_STATUS HC32FLASH_WritedWord_Check(uint32_t u32Addr, uint32_t data)
{
    HC32FLASH_STATUS status;
    uint32_t FRMC_Temp;
    uint32_t read_back_data;
    
    //__disable_irq();                       // 关闭中断
    M4_EFM->FSCLR = 0x3FUL;               // 清除所有错误标记
    HC32FLASH_Unlock();                    // 解锁
    
    FRMC_Temp = M4_EFM->FRMC;              // 记录之前寄存器值
    if (FRMC_Temp & (1UL << 16))           // 使能了缓存，则先关闭
    {
        M4_EFM->FRMC &= ~(1UL << 16);      // 关闭缓存
    }
    
    // 使用单编程回读模式（已经支持回读校验）
    HC32FLASH_SetErasePgmMode(PEMOD_SINGLE_PROGRAM_RB); 
    
    // 写入数据
    *(volatile uint32_t*)u32Addr = data;   
    
    // 等待操作结束
    status = HC32FLASH_WaitDone(10000);    
    
    // 如果状态显示成功，进行额外的读取验证
    if (status == HC32FLASH_OK)
    {
        // 立即读取刚写入的数据进行验证
        read_back_data = HC32FLASH_ReaddWord(u32Addr);
        
        // 如果读取的数据与写入的不一致，认为扇区可能损坏
        if (read_back_data != data)
        {
            status = HC32FLASH_PGMISMTCH;  // 标记为编程不匹配错误
        }
    }
    
    M4_EFM->FSCLR = 0x3FUL;               // 清除所有错误标记
    HC32FLASH_SetErasePgmMode(PEMOD_READ_ONLY); // 退出编程模式
    
    if (FRMC_Temp & (1UL << 16))           // 原来使能了缓存
    {
        M4_EFM->FRMC |= (1UL << 16) | (1UL << 24); // 开启缓存并复位缓存
    }
    
    HC32FLASH_Lock();                      // 上锁
    //__enable_irq();                        // 使能中断

    EFM_DataCacheRstCmd(Disable);

    return status;
}

__inline uint32_t HC32FLASH_ReaddWord(uint32_t u32Addr)
{
    return *(volatile uint32_t*)u32Addr;
}


void flash_test_example(void)
{
    HC32FLASH_STATUS status;


    // 1. 擦除扇区
    status = HC32FLASH_EraseSector(TEST_FLASH_ADDR);
    if (status != HC32FLASH_OK)
    {
        flash_test_result = 1; // 擦除失败标记
        // return;
    }


    // 2. 写入单个字
    status = HC32FLASH_WritedWord_NoCheck(TEST_FLASH_ADDR, 0x33333333);
    if (status != HC32FLASH_OK)
    {
        flash_test_result = 2; // 单字写入失败标记
        // return;
    }

    // 基本使用
    status = HC32FLASH_WritedWord_Check(TEST_FLASH_ADDR+16, 0x12345678);
    if (status != HC32FLASH_OK) {
        flash_test_result = 2; // 单字写入失败标记
        // 处理写入失败
    }

    // 1. 擦除扇区
    status = HC32FLASH_EraseSector(TEST_FLASH_ADDR);
    if (status != HC32FLASH_OK)
    {
        flash_test_result = 1; // 擦除失败标记
        // return;
    }    
    // 2. 写入单个字
    status = HC32FLASH_WritedWord_NoCheck(TEST_FLASH_ADDR, 0x11111111);
    if (status != HC32FLASH_OK)
    {
        flash_test_result = 2; // 单字写入失败标记
        // return;
    }
    uint32_t read_data = HC32FLASH_ReaddWord(TEST_FLASH_ADDR);
    if (read_data != 0x11111111)
    {
        flash_test_result = 3; // 验证失败标记
        PORT_SetBits(GPIO_LED_PORT, GPIO_LED_PIN);
        // return;
    }
}
